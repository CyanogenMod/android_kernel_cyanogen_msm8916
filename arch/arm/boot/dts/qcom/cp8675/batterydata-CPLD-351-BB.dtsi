/* Copyright (c) 2013, The Linux Foundation. All rights reserved.
 *
 * This program is free software; you can redistribute it and/or modify
 * it under the terms of the GNU General Public License version 2 and
 * only version 2 as published by the Free Software Foundation.
 *
 * This program is distributed in the hope that it will be useful,
 * but WITHOUT ANY WARRANTY; without even the implied warranty of
 * MERCHANTABILITY or FITNESS FOR A PARTICULAR PURPOSE.  See the
 * GNU General Public License for more details.
 */

/* manufacturer is 比克电池 */

qcom,CPLD-312-BB-data {
	qcom,fcc-mah = <2500>;
	qcom,default-rbatt-mohm = <221>;
	qcom,rbatt-capacitive-mohm = <0>;
	qcom,flat-ocv-threshold-uv = <3800000>;
	qcom,max-voltage-uv = <4350000>;
	qcom,v-cutoff-uv = <3400000>;
	qcom,chg-term-ua = <100000>;
	qcom,batt-id-kohm = <47>;
	qcom,battery-type = "CPLD-312-BB";

	qcom,rbatt-sf-lut {
		qcom,lut-col-legend = <(-20) 0 25 40 60>;
		qcom,lut-row-legend = <100 95 90 85 80>,
				<75 70 65 60 55>,
				<50 45 40 35 30>,
				<25 20 16 13 11>,
				<10 9 8 7 6>,
				<5 4 3 2 1>,
				<0>;
		qcom,lut-data = <655 191 100 92 88>,
				<836 204 102 93 88>,
				<819 203 101 93 88>,
				<815 210 104 94 89>,
				<752 220 107 96 90>,
				<725 205 109 98 91>,
				<717 197 113 100 94>,
				<713 193 112 102 95>,
				<717 191 105 96 91>,
				<730 192 102 93 89>,
				<751 194 101 93 90>,
				<781 198 103 94 90>,
				<821 206 104 96 92>,
				<874 219 104 96 93>,
				<943 236 104 94 90>,
				<1030 262 103 93 89>,
				<1145 307 104 93 89>,
				<1338 376 104 94 90>,
				<1657 445 103 94 90>,
				<1925 505 107 95 91>,
				<2114 535 109 97 92>,
				<2320 565 112 99 93>,
				<2549 595 114 100 94>,
				<2819 593 115 100 94>,
				<3038 604 113 98 91>,
				<3294 607 111 97 92>,
				<3809 623 114 99 93>,
				<4900 681 120 102 96>,
				<7216 794 130 108 101>,
				<13329 1548 162 128 113>,
				<24329 22630 9610 8180 1644>;
	};

	qcom,fcc-temp-lut {
		qcom,lut-col-legend = <(-20) 0 25 40 60>;
		qcom,lut-data = <2578 2580 2590 2584 2573>;
	};

	qcom,pc-temp-ocv-lut {
		qcom,lut-col-legend = <(-20) 0 25 40 60>;
		qcom,lut-row-legend = <100 95 90 85 80>,
				<75 70 65 60 55>,
				<50 45 40 35 30>,
				<25 20 16 13 11>,
				<10 9 8 7 6>,
				<5 4 3 2 1>,
				<0>;
		qcom,lut-data = <4295 4287 4293 4289 4285>,
				<4208 4216 4229 4228 4224>,
				<4129 4156 4173 4173 4169>,
				<4075 4103 4120 4120 4117>,
				<3991 4050 4072 4070 4067>,
				<3933 3982 4021 4022 4021>,
				<3891 3933 3978 3980 3978>,
				<3853 3894 3933 3936 3935>,
				<3824 3859 3888 3889 3889>,
				<3802 3830 3853 3854 3854>,
				<3785 3807 3827 3828 3827>,
				<3770 3790 3806 3807 3806>,
				<3756 3778 3788 3789 3788>,
				<3741 3769 3774 3773 3770>,
				<3725 3757 3760 3755 3747>,
				<3707 3738 3744 3736 3724>,
				<3684 3712 3723 3715 3703>,
				<3660 3694 3701 3693 3682>,
				<3634 3680 3683 3677 3667>,
				<3612 3671 3679 3673 3663>,
				<3596 3663 3677 3671 3662>,
				<3580 3654 3674 3669 3659>,
				<3560 3644 3670 3665 3655>,
				<3536 3626 3662 3657 3646>,
				<3508 3600 3642 3635 3621>,
				<3475 3565 3605 3598 3582>,
				<3430 3519 3556 3549 3533>,
				<3370 3457 3494 3487 3471>,
				<3288 3374 3412 3405 3390>,
				<3182 3255 3289 3279 3266>,
				<3000 3000 3000 3000 3000>;
	};
};
