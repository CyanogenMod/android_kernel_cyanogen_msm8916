/* Copyright (c) 2014, The Linux Foundation. All rights reserved.
 *
 * This program is free software; you can redistribute it and/or modify
 * it under the terms of the GNU General Public License version 2 and
 * only version 2 as published by the Free Software Foundation.
 *
 * This program is distributed in the hope that it will be useful,
 * but WITHOUT ANY WARRANTY; without even the implied warranty of
 * MERCHANTABILITY or FITNESS FOR A PARTICULAR PURPOSE.  See the
 * GNU General Public License for more details.
 */

&mdss_mdp {
	dsi_otm1283a_boyi_lg_hd: qcom,mdss_dsi_otm1283a_boyi_lg_hd_video {
		qcom,cont-splash-enabled;
		qcom,mdss-dsi-panel-name = "LCD_TYPE_OTM1283A_BOYI_LG_HD_550";
		qcom,mdss-dsi-panel-controller = <&mdss_dsi0>;
		qcom,mdss-dsi-panel-type = "dsi_video_mode";
		qcom,mdss-dsi-panel-destination = "display_1";
		qcom,mdss-dsi-panel-framerate = <60>;
		qcom,mdss-dsi-virtual-channel-id = <0>;
		qcom,mdss-dsi-stream = <0>;
		qcom,mdss-dsi-panel-width = <720>;
		qcom,mdss-dsi-panel-height = <1280>;
		qcom,mdss-dsi-h-front-porch = <52>;
		qcom,mdss-dsi-h-back-porch = <100>;
		qcom,mdss-dsi-h-pulse-width = <24>;
		qcom,mdss-dsi-h-sync-skew = <0>;
		qcom,mdss-dsi-v-front-porch = <20>;
		qcom,mdss-dsi-v-back-porch = <8>;
		qcom,mdss-dsi-v-pulse-width = <4>;
		qcom,mdss-dsi-h-left-border = <0>;
		qcom,mdss-dsi-h-right-border = <0>;
		qcom,mdss-dsi-v-top-border = <0>;
		qcom,mdss-dsi-v-bottom-border = <0>;
		qcom,mdss-dsi-bpp = <24>;
		qcom,mdss-dsi-underflow-color = <0xff>;
		qcom,mdss-dsi-border-color = <0>;
		qcom,mdss-dsi-pixel-packing = <0>;
		qcom,mdss-dsi-on-command = [
			29 01 00 00 00 00 02 00 00
			29 01 00 00 00 00 04 ff 12 83 01
			29 01 00 00 00 00 02 00 80
			29 01 00 00 00 00 03 ff 12 83
			29 01 00 00 00 00 02 00 c6
			29 01 00 00 00 00 02 B0 03
			29 01 00 00 00 00 02 00 B9
			29 01 00 00 00 00 02 B0 51
			29 01 00 00 00 00 02 00 80
			29 01 00 00 00 00 0a c0 00 64 00 0f 11 00 64 0f 11
			29 01 00 00 00 00 02 00 90
			29 01 00 00 00 00 07 c0 00 55 00 01 00 04
			29 01 00 00 00 00 02 00 a4
			29 01 00 00 00 00 02 c0 00
			29 01 00 00 00 00 02 00 b3
			29 01 00 00 00 00 03 c0 00 50
			29 01 00 00 00 00 02 00 81
			29 01 00 00 00 00 02 c1 55
			29 01 00 00 00 00 02 00 80
			29 01 00 00 00 00 02 c4 30
			29 01 00 00 00 00 02 00 81
			29 01 00 00 00 00 02 c4 82
			29 01 00 00 00 00 02 00 82
			29 01 00 00 00 00 02 c4 02
			29 01 00 00 00 00 02 00 87
			29 01 00 00 00 00 02 c4 18
			29 01 00 00 00 00 02 00 8A
			29 01 00 00 00 00 02 c4 40
			29 01 00 00 00 00 02 00 8b
			29 01 00 00 00 00 02 c4 00
			29 01 00 00 00 00 02 00 90
			29 01 00 00 00 00 02 c4 52
			29 01 00 00 00 00 02 00 a0
			29 01 00 00 00 00 0f c4 05 10 06 02 05 15 10 05 10 07 02 05 15 10
			29 01 00 00 00 00 02 00 b0
			29 01 00 00 00 00 03 c4 00 00
			29 01 00 00 00 00 02 00 90
			29 01 00 00 00 00 02 c5 50
			29 01 00 00 00 00 02 00 91
			29 01 00 00 00 00 03 c5 54 50
			29 01 00 00 00 00 02 00 94
			29 01 00 00 00 00 02 c5 66
			29 01 00 00 00 00 02 00 b0
			29 01 00 00 00 00 03 c5 04 38
			29 01 00 00 00 00 02 00 b4
			29 01 00 00 00 00 02 c5 c0
			29 01 00 00 00 00 02 00 bb
			29 01 00 00 00 00 02 c5 80
			29 01 00 00 00 00 02 00 b5
			29 01 00 00 00 00 07 c5 3b ed 30 3b ed 30
			29 01 00 00 00 00 02 00 b1
			29 01 00 00 00 00 02 c6 05
			29 01 00 00 00 00 02 00 90
			29 01 00 00 00 00 05 f5 02 11 02 11
			29 01 00 00 00 00 02 00 b2
			29 01 00 00 00 00 03 f5 00 00
			29 01 00 00 00 00 02 00 b4
			29 01 00 00 00 00 03 f5 00 00
			29 01 00 00 00 00 02 00 b6
			29 01 00 00 00 00 03 f5 00 00
			29 01 00 00 00 00 02 00 b8
			29 01 00 00 00 00 03 f5 00 00
			29 01 00 00 00 00 02 00 94
			29 01 00 00 00 00 02 F5 02
			29 01 00 00 00 00 02 00 BA
			29 01 00 00 00 00 02 F5 03
			29 01 00 00 00 00 02 00 C3
			29 01 00 00 00 00 02 F5 81
			29 01 00 00 00 00 02 00 B1
			29 01 00 00 00 00 02 C6 05
			29 01 00 00 00 00 02 00 80
			29 01 00 00 00 00 0c cb 00 00 00 00 00 00 00 00 00 00 00
			29 01 00 00 00 00 02 00 90
			29 01 00 00 00 00 10 cb 00 00 00 00 00 00 00 00 00 00 00 ff 00 ff 00
			29 01 00 00 00 00 02 00 a0
			29 01 00 00 00 00 10 cb ff 00 ff 00 00 00 00 00 00 00 00 00 00 00 00
			29 01 00 00 00 00 02 00 b0
			29 01 00 00 00 00 10 cb 00 00 00 ff 00 ff 00 ff 00 ff 00 00 00 00 00
			29 01 00 00 00 00 02 00 c0
			29 01 00 00 00 00 10 cb 00 00 00 00 05 05 00 00 05 00 05 05 00 05 05
			29 01 00 00 00 00 02 00 d0
			29 01 00 00 00 00 10 cb 05 05 05 00 00 00 00 00 00 00 00 05 05 00 00
			29 01 00 00 00 00 02 00 e0
			29 01 00 00 00 00 0f cb 05 00 05 05 00 05 05 05 05 05 00 00 00 00
			29 01 00 00 00 00 02 00 f0
			29 01 00 00 00 00 0c cb ff ff ff ff ff ff ff ff ff ff ff
			29 01 00 00 00 00 02 00 80
			29 01 00 00 00 00 10 cc 00 00 00 00 2E 2D 00 00 29 00 2A 0c 00 0a 10
			29 01 00 00 00 00 02 00 90
			29 01 00 00 00 00 10 cc 0e 02 04 00 00 00 00 00 00 00 00 2E 2D 00 00
			29 01 00 00 00 00 02 00 a0
			29 01 00 00 00 00 0f cc 29 00 2A 0b 00 09 0f 0d 01 03 00 00 00 00
			29 01 00 00 00 00 02 00 b0
			29 01 00 00 00 00 10 cc 00 00 00 00 2D 2E 00 00 29 00 2A 0f 00 09 0b
			29 01 00 00 00 00 02 00 c0
			29 01 00 00 00 00 10 cc 0d 03 01 00 00 00 00 00 00 00 00 2D 2E 00 00
			29 01 00 00 00 00 02 00 d0
			29 01 00 00 00 00 0f cc 29 00 2A 10 00 0a 0c 0e 04 02 00 00 00 00
			29 01 00 00 00 00 02 00 80
			29 01 00 00 00 00 0d ce 8b 03 10 8a 03 10 89 03 10 88 03 10
			29 01 00 00 00 00 02 00 90
			29 01 00 00 00 00 0f ce f0 00 00 f0 00 00 f0 00 00 f0 00 00 00 00
			29 01 00 00 00 00 02 00 a0
			29 01 00 00 00 00 0f ce 38 07 84 fe 00 10 00 38 06 84 ff 00 10 00
			29 01 00 00 00 00 02 00 b0
			29 01 00 00 00 00 0f ce 38 05 85 00 00 10 00 38 04 85 01 00 10 00
			29 01 00 00 00 00 02 00 c0
			29 01 00 00 00 00 0f ce 38 03 85 02 00 10 00 38 02 85 03 00 10 00
			29 01 00 00 00 00 02 00 d0
			29 01 00 00 00 00 0f ce 38 01 85 04 00 10 00 38 00 85 05 00 10 00
			29 01 00 00 00 00 02 00 80
			29 01 00 00 00 00 0f cf 70 00 00 10 00 00 00 70 00 00 10 00 00 00
			29 01 00 00 00 00 02 00 90
			29 01 00 00 00 00 0f cf 70 00 00 10 00 00 00 70 00 00 10 00 00 00
			29 01 00 00 00 00 02 00 a0
			29 01 00 00 00 00 0f cf 70 00 00 10 00 00 00 70 00 00 10 00 00 00
			29 01 00 00 00 00 02 00 b0
			29 01 00 00 00 00 0f cf 70 00 00 10 00 00 00 70 00 00 10 00 00 00
			29 01 00 00 00 00 02 00 c0
			29 01 00 00 00 00 0c cf 04 01 20 20 00 00 01 80 00 03 08
			29 01 00 00 00 00 02 00 C2
			29 01 00 00 00 00 02 F5 C0
			29 01 00 00 00 00 02 00 80
			29 01 00 00 00 00 02 C4 01
			29 01 00 00 00 00 02 00 88
			29 01 00 00 00 00 02 C4 80
			29 01 00 00 00 00 02 00 00
			29 01 00 00 00 00 03 d8 bc bc
			29 01 00 00 00 00 02 00 00
			29 01 00 00 00 00 02 d9 8b
			29 01 00 00 00 00 02 00 00
			29 01 00 00 00 00 11 E1 04 0b 10 0d 06 0e 0c 0a 04 07 0c 09 10 16 12 08
			29 01 00 00 00 00 02 00 00
			29 01 00 00 00 00 11 E2 04 0B 10 0D 07 0E 0C 0A 04 09 0C 09 10 16 12 08
			29 01 00 00 00 00 02 00 A0
			29 01 00 00 00 00 0d D6 01 00 01 00 01 00 01 b3 01 f3 01 b3
			29 01 00 00 00 00 02 00 B0
			29 01 00 00 00 00 0d D6 01 b3 01 b3 01 b3 01 b3 01 b3 01 b3
			29 01 00 00 00 00 02 00 C0
			29 01 00 00 00 00 0d D6 1e 11 00 77 11 77 a2 11 77 77 11 77
			29 01 00 00 00 00 02 00 D0
			29 01 00 00 00 00 07 D6 77 11 77 77 11 77
			29 01 00 00 00 00 02 00 E0
			29 01 00 00 00 00 0d D6 1e 11 3c 3c 11 3c 51 11 3c 3c 11 3c
			29 01 00 00 00 00 02 00 F0
			29 01 00 00 00 00 07 D6 3c 11 3c 3c 11 3c
			29 01 00 00 00 00 02 00 90
			29 01 00 00 00 00 02 D6 80
			29 01 00 00 00 00 02 00 81
			29 01 00 00 00 00 03 D6 03 FF
			29 01 00 00 00 00 02 00 80
			29 01 00 00 00 00 1d CA 01 8E 95 9D A4 AB B2 BA C1 C8 CF D7 DE E5 EC F4 E8 FF 87 FF 87 FF 05 03 05 03 05 03
			29 01 00 00 00 00 02 00 00
			29 01 00 00 00 00 02 C6 10
			29 01 00 00 00 00 13 C7 90 A9 AA AA AA AA AA AA 99 88 88 88 77 66 55 55 55 55
			29 01 00 00 00 00 02 00 00
			29 01 00 00 00 00 02 C6 11
			29 01 00 00 00 00 13 C7 90 99 AA AA AA AA AA 9A 99 88 88 88 77 66 66 55 55 55
			29 01 00 00 00 00 02 00 00
			29 01 00 00 00 00 02 C6 12
			29 01 00 00 00 00 13 C7 90 99 A9 AA AA AA AA 99 99 88 88 88 77 66 66 66 55 55
			29 01 00 00 00 00 02 00 00
			29 01 00 00 00 00 02 C6 13
			29 01 00 00 00 00 13 C7 90 99 99 AA AA AA 9A 99 99 88 88 88 77 66 66 66 66 55
			29 01 00 00 00 00 02 00 00
			29 01 00 00 00 00 02 C6 14
			29 01 00 00 00 00 13 C7 90 99 99 A9 AA AA 99 99 99 88 88 88 77 66 66 66 66 66
			29 01 00 00 00 00 02 00 00
			29 01 00 00 00 00 02 C6 15
			29 01 00 00 00 00 13 C7 90 99 99 99 AA 9A 99 99 99 88 88 88 77 77 66 66 66 66
			29 01 00 00 00 00 02 00 00
			29 01 00 00 00 00 02 C6 16
			29 01 00 00 00 00 13 C7 90 99 99 99 A9 99 99 99 99 88 88 88 77 77 77 66 66 66
			29 01 00 00 00 00 02 00 00
			29 01 00 00 00 00 02 00 17
			29 01 00 00 00 00 13 C7 80 99 99 99 99 99 99 99 99 88 88 88 77 77 77 77 66 66
			29 01 00 00 00 00 02 00 00
			29 01 00 00 00 00 02 00 18
			29 01 00 00 00 00 13 C7 80 98 99 99 99 98 99 99 99 88 88 88 77 77 77 77 77 66
			29 01 00 00 00 00 02 00 00
			29 01 00 00 00 00 02 C6 19
			29 01 00 00 00 00 13 C7 80 88 99 99 99 88 99 99 99 88 88 88 77 77 77 77 77 77
			29 01 00 00 00 00 02 00 00
			29 01 00 00 00 00 02 C6 1A
			29 01 00 00 00 00 13 C7 80 88 98 99 99 88 98 99 99 88 88 88 88 77 77 77 77 77
			29 01 00 00 00 00 02 00 00
			29 01 00 00 00 00 02 C6 1B
			29 01 00 00 00 00 13 C7 80 88 88 99 99 88 88 99 99 88 88 88 88 88 77 77 77 77
			29 01 00 00 00 00 02 00 00
			29 01 00 00 00 00 02 C6 1C
			29 01 00 00 00 00 13 C7 80 88 88 98 99 88 88 98 99 88 88 88 88 88 88 77 77 77
			29 01 00 00 00 00 02 00 00
			29 01 00 00 00 00 02 00 1D
			29 01 00 00 00 00 13 C7 80 88 88 88 99 88 88 88 99 88 88 88 88 88 88 88 77 77
			29 01 00 00 00 00 02 00 00
			29 01 00 00 00 00 02 C6 1E
			29 01 00 00 00 00 13 C7 80 88 88 88 98 88 88 88 98 88 88 88 88 88 88 88 78 78
			29 01 00 00 00 00 02 00 00
			29 01 00 00 00 00 02 C6 1F
			29 01 00 00 00 00 13 C7 80 88 88 88 88 88 88 88 88 88 88 88 88 88 88 88 88 88
			29 01 00 00 00 00 02 00 00
			29 01 00 00 00 00 02 C6 00
			29 01 00 00 00 00 02 00 A0
			29 01 00 00 00 00 02 C1 02
			29 01 00 00 00 00 02 00 80
			29 01 00 00 00 00 03 ff ff ff
			29 01 00 00 00 00 02 00 00
			29 01 00 00 00 00 04 ff ff ff ff
			29 01 00 00 00 00 02 51 00
			29 01 00 00 00 00 02 53 24
			05 01 00 00 01 00 02 11 00
		];
		qcom,mdss-dsi-off-command = [
			05 01 00 00 14 00 02 28 00
			05 01 00 00 78 00 02 10 00
		];
		cm,mdss-livedisplay-cabc-cmd = [
			29 01 00 00 00 00 02 55 00
		];
		cm,mdss-livedisplay-cabc-ui-value = <0x01>;
		cm,mdss-livedisplay-cabc-image-value = <0x02>;
		cm,mdss-livedisplay-cabc-video-value = <0x03>;
		cm,mdss-livedisplay-cabc-ce-value = <0x80>;
		cm,mdss-livedisplay-post-cmd = [
			05 01 00 00 00 00 02 29 00
		];
		qcom,panel-backlight-response-curve = [
			00 01 02 02 03 03 03 04
			04 05 06 06 07 08 09 0A
			0A 0B 0C 0C 0D 0D 0E 0E
			0F 0F 0F 10 10 10 10 11
			11 11 11 12 12 12 12 13
			13 13 13 14 14 14 15 15
			15 16 16 16 17 18 18 19
			1A 1B 1B 1C 1D 1D 1E 1F
			21 21 21 22 23 23 24 25
			26 26 27 27 28 28 29 29
			2A 2A 2B 2B 2C 2C 2D 2D
			2E 2E 2F 2F 30 30 31 31
			31 32 32 33 33 33 34 34
			34 35 37 38 3A 3B 3D 3E
			3F 40 41 42 43 44 45 46
			47 48 49 4A 4B 4C 4D 4E
			4F 50 51 51 52 53 54 54
			55 56 57 57 58 59 5A 5B
			5C 5E 5F 61 62 64 65 67
			68 6A 6B 6C 6E 6F 71 72
			74 75 77 78 7A 7B 7D 7E
			7F 81 82 84 85 87 89 8B
			8C 8D 8E 90 91 92 94 95
			97 98 9A 9B 9D 9E A0 A1
			A3 A4 A5 A7 A8 AA AB AD
			AE AF B1 B3 B4 B5 B7 B8
			BA BB BD BE BF C1 C4 C5
			C7 C8 C9 CA CB CD CE D0
			D1 D3 D4 D6 D7 D9 DA DB
			DD DE E0 E1 E3 E4 E6 E7
			E9 EA EC ED EE F0 F1 F3
			F4 F6 F7 F9 FA FC FD FF
		];
		qcom,mdss-dsi-on-command-state = "dsi_lp_mode";
		qcom,mdss-dsi-off-command-state = "dsi_lp_mode";
		qcom,panel-alive-reg-content = [
			0A 01 9C
			0B 01 00
			0D 01 00
		];
		qcom,mdss-dsi-panel-status-command = [
			06 01 00 01 05 00 02 0A 08
		];
		qcom,mdss-dsi-panel-status-command-state = "dsi_lp_mode";
		qcom,mdss-dsi-panel-status-check-mode = "reg_read_yl";
		qcom,mdss-dsi-h-sync-pulse = <1>;
		qcom,mdss-dsi-traffic-mode = "burst_mode";
		qcom,mdss-dsi-bllp-eof-power-mode;
		qcom,mdss-dsi-bllp-power-mode;
		qcom,mdss-dsi-lane-0-state;
		qcom,mdss-dsi-lane-1-state;
		qcom,mdss-dsi-lane-2-state;
		qcom,mdss-dsi-lane-3-state;
		qcom,mdss-dsi-panel-timings = [92 1A 12 00 3E 42 16 1E 14 03 04 00];
		qcom,mdss-dsi-t-clk-post = <0x04>;
		qcom,mdss-dsi-t-clk-pre = <0x1C>;
		qcom,mdss-dsi-bl-min-level = <1>;
		qcom,mdss-dsi-bl-max-level = <255>;
		qcom,mdss-dsi-dma-trigger = "trigger_sw";
		qcom,mdss-dsi-mdp-trigger = "none";
		qcom,mdss-dsi-bl-pmic-control-type = "bl_ctrl_dcs";
		qcom,mdss-dsi-reset-sequence = <1 10>, <0 2>, <1 10>;
		qcom,mdss-pan-physical-width-dimension = <68>;
		qcom,mdss-pan-physical-height-dimension = <121>;
	};
};
