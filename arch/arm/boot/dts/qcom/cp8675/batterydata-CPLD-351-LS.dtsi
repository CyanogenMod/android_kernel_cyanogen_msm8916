/* Copyright (c) 2013, The Linux Foundation. All rights reserved.
 *
 * This program is free software; you can redistribute it and/or modify
 * it under the terms of the GNU General Public License version 2 and
 * only version 2 as published by the Free Software Foundation.
 *
 * This program is distributed in the hope that it will be useful,
 * but WITHOUT ANY WARRANTY; without even the implied warranty of
 * MERCHANTABILITY or FITNESS FOR A PARTICULAR PURPOSE.  See the
 * GNU General Public License for more details.
 */

/* manufacturer is 天津力神电池股份有限公司 */

qcom,CPLD-312-LS-data {
	qcom,fcc-mah = <2500>;
	qcom,default-rbatt-mohm = <221>;
	qcom,rbatt-capacitive-mohm = <0>;
	qcom,flat-ocv-threshold-uv = <3800000>;
	qcom,max-voltage-uv = <4350000>;
	qcom,v-cutoff-uv = <3400000>;
	qcom,chg-term-ua = <100000>;
	qcom,batt-id-kohm = <220>;
	qcom,battery-type = "CPLD-312-LS";

	qcom,rbatt-sf-lut {
		qcom,lut-col-legend = <(-20) 0 25 40 60>;
		qcom,lut-row-legend = <100 95 90 85 80>,
				<75 70 65 60 55>,
				<50 45 40 35 30>,
				<25 20 16 13 11>,
				<10 9 8 7 6>,
				<5 4 3 2 1>,
				<0>;
		qcom,lut-data = <690 289 100 81 74>,
				<689 288 100 80 74>,
				<657 280 101 82 75>,
				<626 272 103 84 76>,
				<621 266 104 86 77>,
				<578 261 108 89 78>,
				<562 245 112 91 80>,
				<564 243 117 96 83>,
				<561 247 109 93 85>,
				<567 255 104 84 80>,
				<592 268 107 83 76>,
				<628 289 111 85 77>,
				<672 317 116 88 79>,
				<719 349 121 90 81>,
				<763 386 128 90 80>,
				<811 433 135 89 78>,
				<867 485 143 89 78>,
				<922 520 152 91 78>,
				<940 566 161 90 78>,
				<965 620 167 92 78>,
				<1002 651 173 94 80>,
				<1046 688 180 96 80>,
				<1096 728 190 99 82>,
				<1190 772 198 100 83>,
				<1384 820 207 100 83>,
				<1707 871 214 100 81>,
				<2193 948 228 103 83>,
				<3022 1109 249 109 85>,
				<4621 1409 278 123 95>,
				<11415 2907 471 217 152>,
				<69815 17735 15567 14532 14463>;
	};

	qcom,fcc-temp-lut {
		qcom,lut-col-legend = <(-20) 0 25 40 60>;
		qcom,lut-data = <2578 2580 2590 2584 2573>;
	};

	qcom,pc-temp-ocv-lut {
		qcom,lut-col-legend = <(-20) 0 25 40 60>;
		qcom,lut-row-legend = <100 95 90 85 80>,
				<75 70 65 60 55>,
				<50 45 40 35 30>,
				<25 20 16 13 11>,
				<10 9 8 7 6>,
				<5 4 3 2 1>,
				<0>;
		qcom,lut-data = <4317 4350 4296 4339 4335>,
				<4227 4267 4229 4279 4276>,
				<4159 4204 4174 4223 4219>,
				<4091 4146 4122 4168 4163>,
				<4046 4091 4073 4114 4109>,
				<3973 4036 4027 4064 4058>,
				<3919 3972 3984 4016 4011>,
				<3879 3926 3943 3972 3968>,
				<3841 3886 3893 3923 3924>,
				<3811 3852 3854 3877 3878>,
				<3795 3824 3827 3845 3843>,
				<3781 3803 3806 3821 3818>,
				<3767 3789 3788 3799 3798>,
				<3753 3776 3774 3781 3780>,
				<3739 3762 3763 3763 3760>,
				<3725 3746 3748 3744 3735>,
				<3708 3723 3725 3723 3713>,
				<3691 3700 3698 3698 3689>,
				<3676 3686 3678 3677 3668>,
				<3663 3679 3673 3674 3664>,
				<3654 3675 3671 3673 3663>,
				<3643 3671 3669 3671 3661>,
				<3630 3667 3666 3668 3660>,
				<3613 3659 3660 3662 3655>,
				<3592 3645 3647 3646 3643>,
				<3564 3616 3614 3610 3608>,
				<3528 3573 3565 3559 3558>,
				<3476 3513 3500 3492 3493>,
				<3394 3425 3414 3400 3406>,
				<3257 3298 3290 3275 3278>,
				<3000 3000 3000 3000 3000>;
	};
};
