/* Copyright (c) 2013, The Linux Foundation. All rights reserved.
 *
 * This program is free software; you can redistribute it and/or modify
 * it under the terms of the GNU General Public License version 2 and
 * only version 2 as published by the Free Software Foundation.
 *
 * This program is distributed in the hope that it will be useful,
 * but WITHOUT ANY WARRANTY; without even the implied warranty of
 * MERCHANTABILITY or FITNESS FOR A PARTICULAR PURPOSE.  See the
 * GNU General Public License for more details.
 */

/* manufacturer is 东莞市迈科新能源有限公司 */

qcom,CPLD-312-MK-data {
	qcom,fcc-mah = <2500>;
	qcom,default-rbatt-mohm = <198>;
	qcom,rbatt-capacitive-mohm = <0>;
	qcom,flat-ocv-threshold-uv = <3800000>;
	qcom,max-voltage-uv = <4350000>;
	qcom,v-cutoff-uv = <3400000>;
	qcom,chg-term-ua = <100000>;
	qcom,batt-id-kohm = <100>;
	qcom,battery-type = "CPLD-312-MK";

	qcom,fcc-temp-lut {
		qcom,lut-col-legend = <(-20) 0 25 40 60>;
		qcom,lut-data = <3030 3033 3037 3035 3031>;
	};

	qcom,rbatt-sf-lut {
		qcom,lut-col-legend = <(-20) 0 25 40 60>;
		qcom,lut-row-legend = <100 95 90 85 80>,
				<75 70 65 60 55>,
				<50 45 40 35 30>,
				<25 20 16 13 11>,
				<10 9 8 7 6>,
				<5 4 3 2 1>,
				<0>;
		qcom,lut-data = <770 214 100 83 79>,
				<769 214 100 83 79>,
				<734 219 101 86 80>,
				<698 221 103 80 81>,
				<693 218 107 81 82>,
				<645 217 111 83 84>,
				<628 203 115 86 87>,
				<630 196 115 91 89>,
				<626 196 104 91 90>,
				<633 195 96 80 83>,
				<661 196 96 77 81>,
				<701 196 98 79 82>,
				<751 197 100 81 84>,
				<802 205 102 83 87>,
				<852 219 103 82 85>,
				<906 237 102 80 82>,
				<968 254 103 80 83>,
				<1029 275 102 80 83>,
				<1049 281 98 77 81>,
				<1077 303 101 78 82>,
				<1119 318 104 80 83>,
				<1167 340 108 82 85>,
				<1223 364 112 84 87>,
				<1328 395 115 86 88>,
				<1544 435 114 87 87>,
				<1906 489 113 85 84>,
				<2447 586 118 84 85>,
				<3373 748 128 87 89>,
				<5158 1006 157 94 97>,
				<12741 5614 4390 120 145>,
				<77925 45169 44470 19375 16302>;
	};

	qcom,pc-temp-ocv-lut {
		qcom,lut-col-legend = <(-20) 0 25 40 60>;
		qcom,lut-row-legend = <100 95 90 85 80>,
				<75 70 65 60 55>,
				<50 45 40 35 30>,
				<25 20 16 13 11>,
				<10 9 8 7 6>,
				<5 4 3 2 1>,
				<0>;
		qcom,lut-data = <4317 4336 4329 4333 4328>,
				<4227 4264 4264 4268 4263>,
				<4159 4203 4206 4211 4206>,
				<4091 4146 4150 4154 4151>,
				<4046 4088 4098 4102 4098>,
				<3973 4032 4049 4052 4048>,
				<3919 3969 3998 4005 4003>,
				<3879 3925 3953 3964 3961>,
				<3841 3889 3904 3920 3918>,
				<3811 3856 3865 3872 3871>,
				<3795 3828 3836 3839 3839>,
				<3781 3804 3813 3816 3815>,
				<3767 3784 3794 3797 3796>,
				<3753 3770 3778 3781 3779>,
				<3739 3757 3764 3765 3758>,
				<3725 3741 3749 3747 3734>,
				<3708 3720 3730 3728 3714>,
				<3691 3706 3704 3704 3690>,
				<3676 3697 3685 3681 3669>,
				<3663 3690 3680 3676 3665>,
				<3654 3686 3679 3675 3664>,
				<3643 3682 3677 3674 3662>,
				<3630 3677 3674 3672 3660>,
				<3613 3668 3667 3668 3656>,
				<3592 3650 3647 3659 3642>,
				<3564 3617 3606 3632 3607>,
				<3528 3568 3549 3586 3556>,
				<3476 3499 3474 3525 3493>,
				<3394 3404 3370 3444 3408>,
				<3257 3269 3246 3327 3281>,
				<3000 3000 3000 3000 3000>;
	};
};
