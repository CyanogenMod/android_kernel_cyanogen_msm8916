/* Copyright (c) 2014, The Linux Foundation. All rights reserved.
 *
 * This program is free software; you can redistribute it and/or modify
 * it under the terms of the GNU General Public License version 2 and
 * only version 2 as published by the Free Software Foundation.
 *
 * This program is distributed in the hope that it will be useful,
 * but WITHOUT ANY WARRANTY; without even the implied warranty of
 * MERCHANTABILITY or FITNESS FOR A PARTICULAR PURPOSE.  See the
 * GNU General Public License for more details.
 */

#include "dsi-panel-hx8394a-lide-lg-hd-550-video.dtsi"
#include "dsi-panel-otm1283a-boyi-lg-hd-550-video.dtsi"
#include "dsi-panel-otm1283a-lide-cpt-hd-550-video.dtsi"
#include "dsi-panel-nt35596-yashi-otp-id22-auo-fhd-550-video.dtsi"
#include "dsi-panel-r63315-tianma-tm-fhd-550-video.dtsi"
