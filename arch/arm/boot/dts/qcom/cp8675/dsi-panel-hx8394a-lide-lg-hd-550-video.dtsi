/* Copyright (c) 2014, The Linux Foundation. All rights reserved.
 *
 * This program is free software; you can redistribute it and/or modify
 * it under the terms of the GNU General Public License version 2 and
 * only version 2 as published by the Free Software Foundation.
 *
 * This program is distributed in the hope that it will be useful,
 * but WITHOUT ANY WARRANTY; without even the implied warranty of
 * MERCHANTABILITY or FITNESS FOR A PARTICULAR PURPOSE.  See the
 * GNU General Public License for more details.
 */

&mdss_mdp {
	dsi_hx8394a_lide_lg_hd: qcom,mdss_dsi_hx8394a_lide_lg_hd_video {
		qcom,cont-splash-enabled;
		qcom,mdss-dsi-panel-name = "LCD_TYPE_HX8394A_LIDE_LG_HD_550";
		qcom,mdss-dsi-panel-controller = <&mdss_dsi0>;
		qcom,mdss-dsi-panel-type = "dsi_video_mode";
		qcom,mdss-dsi-panel-destination = "display_1";
		qcom,mdss-dsi-panel-framerate = <55>;
		qcom,mdss-dsi-virtual-channel-id = <0>;
		qcom,mdss-dsi-stream = <0>;
		qcom,mdss-dsi-panel-width = <720>;
		qcom,mdss-dsi-panel-height = <1280>;
		qcom,mdss-dsi-h-front-porch = <86>;
		qcom,mdss-dsi-h-back-porch = <100>;
		qcom,mdss-dsi-h-pulse-width = <10>;
		qcom,mdss-dsi-h-sync-skew = <0>;
		qcom,mdss-dsi-v-back-porch = <9>;
		qcom,mdss-dsi-v-front-porch = <2>;
		qcom,mdss-dsi-v-pulse-width = <2>;
		qcom,mdss-dsi-h-left-border = <0>;
		qcom,mdss-dsi-h-right-border = <0>;
		qcom,mdss-dsi-v-top-border = <0>;
		qcom,mdss-dsi-v-bottom-border = <0>;
		qcom,mdss-dsi-bpp = <24>;
		qcom,mdss-dsi-underflow-color = <0xff>;
		qcom,mdss-dsi-border-color = <0>;
		qcom,mdss-dsi-pixel-packing = <0>;
		qcom,mdss-dsi-on-command = [
			39 01 00 00 00 00 04 B9 FF 83 94
			39 01 00 00 02 00 11 BA 13 02 00 16 C5 40 10 ff 0f 04 03 21 24 25 20 08
			39 01 00 00 00 00 11 B1 01 00 04 86 01 11 11 31 39 29 29 47 02 01 E6 E2
			39 01 00 00 00 00 17 B4 80 09 32 10 00 32 15 08 32 10 08 33 04 43 04 37 04 43 06 61 61 06
			39 01 00 00 00 00 07 B2 00 C8 09 00 00 33
			39 01 00 00 00 00 37 D5 00 00 00 00 0A 00 01 00 CC 00 00 00 88 88 88 88 99 88 88 88 AA BB 23 01 67 45 01 23 88 88 88 88 88 88 88 88 88 99 88 88 BB AA 54 76 10 32 32 10 88 88 88 88 3C 01
			39 01 00 00 00 00 05 C7 00 10 00 10
			39 01 00 00 00 00 02 CC 09
			39 01 00 00 00 00 02 BC 07
			39 01 00 00 00 00 03 C0 0C 17
			39 01 00 00 00 00 80 C1 01 00 0A 16 1B 27 2E 35 3F 45 4F 56 60 66 6C 76 7C 82 8A 92 9C A4 A9 B2 BB C0 C8 CE D8 DE E7 F2 F9 FF 7A E7 D4 72 46 74 94 E1 C0 00 0A 16 1B 27 2E 35 3F 45 4F 56 60 66 6C 76 7C 82 8A 92 9C A4 A9 B2 BB C0 C8 CE D8 DE E7 F2 F9 FF 7A E7 D4 72 46 74 94 E1 C0 00 0A 16 1B 27 2E 35 3F 45 4F 56 60 66 6C 76 7C 82 8A 92 9C A4 A9 B2 BB C0 C8 CE D8 DE E7 F2 F9 FF 7A E7 D4 72 46 74 94 E1 C0
			39 01 00 00 00 00 05 BF 06 00 10 04
			39 01 00 00 00 00 02 B6 06
			39 01 00 00 00 00 2B E0 01 12 18 3F 3F 3F 21 3F 06 0C 0D 10 12 10 12 0D 19 01 12 18 3F 3F 3F 21 3F 06 0C 0D 10 12 10 12 0D 19 0A 17 06 0E 0A 17 06 0E
			39 01 00 00 01 00 0C C9 0F 00 1E 1E 00 00 00 01 3E 00 00
			39 01 00 00 00 00 02 51 00
			39 01 00 00 00 00 02 53 24
			39 01 00 00 00 00 02 B9 00
			05 01 00 00 01 00 02 11 00
			39 01 00 00 00 00 04 B9 FF 83 94
			39 01 00 00 01 00 0A CA 2C 2C 2C 2B 2B 2B 2A 2A 20
		];
		qcom,mdss-dsi-off-command = [
			05 01 00 00 14 00 02 28 00
			05 01 00 00 78 00 02 10 00
		];
		cm,mdss-livedisplay-cabc-cmd = [
			39 01 00 00 00 00 02 55 00
		];
		cm,mdss-livedisplay-cabc-ui-value = <0x01>;
		cm,mdss-livedisplay-cabc-image-value = <0x2>;
		cm,mdss-livedisplay-cabc-video-value = <0x3>;
		cm,mdss-livedisplay-color-enhance-on = [
			39 01 00 00 00 00 04 B9 FF 83 94
			39 01 00 00 00 00 02 E4 11
			39 01 00 00 00 00 02 B9 00
		];
		cm,mdss-livedisplay-color-enhance-off = [
			39 01 00 00 00 00 04 B9 FF 83 94
			39 01 00 00 00 00 02 E4 00
			39 01 00 00 00 00 02 B9 00
		];
		cm,mdss-livedisplay-post-cmd = [
			05 01 00 00 10 00 02 29 00
		];
		qcom,panel-backlight-response-curve = [
			00 01 02 03 04 05 06 07
			07 07 07 09 0A 0A 0B 0B
			0C 0C 0D 0D 0E 0E 0F 0F
			0F 0F 0F 10 10 10 10 11
			11 11 11 12 12 12 12 13
			13 13 13 14 14 14 15 15
			15 16 16 16 17 18 18 19
			1A 1B 1B 1C 1D 1D 1E 1F
			21 21 21 22 23 23 24 25
			26 26 27 27 28 28 29 29
			2A 2A 2B 2B 2C 2C 2D 2D
			2E 2E 2F 2F 30 30 31 31
			31 32 32 33 33 33 34 34
			34 35 37 38 3A 3B 3D 3E
			3F 40 41 42 43 44 45 46
			47 48 49 4A 4B 4C 4D 4E
			4F 50 51 51 52 53 54 54
			55 56 57 57 58 59 5A 5B
			5C 5E 5F 61 62 64 65 67
			68 6A 6B 6C 6E 6F 71 72
			74 75 77 78 7A 7B 7D 7E
			7F 81 82 84 85 87 89 8B
			8C 8D 8E 90 91 92 94 95
			97 98 9A 9B 9D 9E A0 A1
			A3 A4 A5 A7 A8 AA AB AD
			AE AF B1 B3 B4 B5 B7 B8
			BA BB BD BE BF C1 C4 C5
			C7 C8 C9 CA CB CD CE D0
			D1 D3 D4 D6 D7 D9 DA DB
			DD DE E0 E1 E3 E4 E6 E7
			E9 EA EC ED EE F0 F1 F3
			F4 F6 F7 F9 FA FC FD FF
		];
		qcom,mdss-dsi-on-command-state = "dsi_lp_mode";
		qcom,mdss-dsi-off-command-state = "dsi_lp_mode";
		qcom,panel-alive-reg-content = [
			09 04 80 73 04 00
		];
		qcom,mdss-dsi-panel-status-command = [
			39 01 00 00 00 00 04 B9 FF 83 94
			39 01 00 00 02 00 0B BA 73 42 00 16 D5 40 10 00 00 24
		];
		qcom,mdss-dsi-panel-status-command-state = "dsi_lp_mode";
		qcom,mdss-dsi-panel-status-check-mode = "reg_read_yl";
		qcom,mdss-dsi-h-sync-pulse = <1>;
		qcom,mdss-dsi-traffic-mode = "burst_mode";
		qcom,mdss-dsi-bllp-eof-power-mode;
		qcom,mdss-dsi-bllp-power-mode;
		qcom,mdss-dsi-lane-0-state;
		qcom,mdss-dsi-lane-1-state;
		qcom,mdss-dsi-lane-2-state;
		qcom,mdss-dsi-lane-3-state;
		qcom,mdss-dsi-panel-timings = [83 1F 17 00 30 2E 1C 21 26 03 04 00];
		qcom,mdss-dsi-t-clk-post = <0x20>;
		qcom,mdss-dsi-t-clk-pre = <0x2C>;
		qcom,mdss-dsi-bl-min-level = <1>;
		qcom,mdss-dsi-bl-max-level = <255>;
		qcom,mdss-dsi-dma-trigger = "trigger_sw";
		qcom,mdss-dsi-mdp-trigger = "none";
		qcom,mdss-dsi-bl-pmic-control-type = "bl_ctrl_dcs";
		qcom,mdss-dsi-reset-sequence = <1 10>, <0 2>, <1 10>;
		qcom,mdss-pan-physical-width-dimension = <68>;
		qcom,mdss-pan-physical-height-dimension = <121>;
		qcom,has-tps65132;
	};
};
