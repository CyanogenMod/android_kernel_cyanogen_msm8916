/* Copyright (c) 2013, The Linux Foundation. All rights reserved.
 *
 * This program is free software; you can redistribute it and/or modify
 * it under the terms of the GNU General Public License version 2 and
 * only version 2 as published by the Free Software Foundation.
 *
 * This program is distributed in the hope that it will be useful,
 * but WITHOUT ANY WARRANTY; without even the implied warranty of
 * MERCHANTABILITY or FITNESS FOR A PARTICULAR PURPOSE.  See the
 * GNU General Public License for more details.
 */

/* manufacturer is 中山天贸电池有限公司 */

qcom,CPLD-312-TM-data {
	qcom,fcc-mah = <2500>;
	qcom,default-rbatt-mohm = <177>;
	qcom,rbatt-capacitive-mohm = <0>;
	qcom,flat-ocv-threshold-uv = <3800000>;
	qcom,max-voltage-uv = <4350000>;
	qcom,v-cutoff-uv = <3400000>;
	qcom,chg-term-ua = <100000>;
	qcom,batt-id-kohm = <1000>;
	qcom,battery-type = "CPLD-312-TM";

	qcom,rbatt-sf-lut {
		qcom,lut-col-legend = <(-20) 0 25 40 60>;
		qcom,lut-row-legend = <100 95 90 85 80>,
				<75 70 65 60 55>,
				<50 45 40 35 30>,
				<25 20 16 13 11>,
				<10 9 8 7 6>,
				<5 4 3 2 1>,
				<0>;
		qcom,lut-data = <1097 243 100 88 85>,
				<1094 243 100 88 85>,
				<1000 242 100 89 86>,
				<949 244 101 89 87>,
				<911 240 103 91 87>,
				<832 253 110 94 88>,
				<832 216 110 96 90>,
				<829 216 116 98 93>,
				<833 218 104 93 90>,
				<848 216 98 88 87>,
				<867 219 98 89 87>,
				<890 223 100 89 88>,
				<916 229 102 91 88>,
				<949 238 103 93 90>,
				<989 250 103 92 88>,
				<1041 262 102 89 88>,
				<1104 275 103 90 88>,
				<1160 294 104 90 88>,
				<1193 310 103 90 87>,
				<1167 321 103 90 88>,
				<1201 330 105 91 89>,
				<1235 342 106 92 89>,
				<1275 356 109 93 90>,
				<1316 367 111 94 90>,
				<1379 379 110 92 89>,
				<1550 394 110 93 89>,
				<1809 420 113 94 90>,
				<2225 454 119 98 94>,
				<3528 510 132 111 100>,
				<22458 5145 1517 1750 512>,
				<120201 56027 44417 65354 36303>;
	};

	qcom,fcc-temp-lut {
		qcom,lut-col-legend = <(-20) 0 25 40 60>;
		qcom,lut-data = <2578 2580 2590 2584 2573>;
	};

	qcom,pc-temp-ocv-lut {
		qcom,lut-col-legend = <(-20) 0 25 40 60>;
		qcom,lut-row-legend = <100 95 90 85 80>,
				<75 70 65 60 55>,
				<50 45 40 35 30>,
				<25 20 16 13 11>,
				<10 9 8 7 6>,
				<5 4 3 2 1>,
				<0>;
		qcom,lut-data = <4325 4328 4323 4317 4313>,
				<4222 4253 4258 4255 4252>,
				<4148 4195 4202 4199 4196>,
				<4096 4142 4147 4145 4142>,
				<4040 4090 4095 4092 4091>,
				<3950 4043 4051 4045 4042>,
				<3911 3960 3989 3994 3997>,
				<3874 3922 3952 3954 3955>,
				<3841 3890 3904 3906 3907>,
				<3817 3857 3866 3866 3866>,
				<3799 3830 3839 3839 3839>,
				<3783 3806 3816 3816 3816>,
				<3769 3787 3797 3798 3797>,
				<3756 3772 3781 3781 3779>,
				<3741 3759 3765 3762 3755>,
				<3725 3744 3749 3741 3729>,
				<3705 3725 3731 3721 3709>,
				<3684 3711 3711 3702 3690>,
				<3664 3702 3693 3684 3672>,
				<3647 3696 3688 3680 3669>,
				<3636 3692 3686 3679 3667>,
				<3622 3687 3684 3677 3665>,
				<3607 3679 3681 3673 3662>,
				<3588 3665 3673 3664 3652>,
				<3566 3644 3652 3641 3626>,
				<3536 3611 3613 3601 3587>,
				<3499 3568 3562 3549 3537>,
				<3447 3508 3496 3483 3472>,
				<3364 3419 3405 3392 3382>,
				<3201 3253 3234 3218 3220>,
				<3000 3000 3000 3000 3000>;
	};
};
