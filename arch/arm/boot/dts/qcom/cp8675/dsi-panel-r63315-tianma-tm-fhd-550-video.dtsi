/* Copyright (c) 2014, The Linux Foundation. All rights reserved.
 *
 * This program is free software; you can redistribute it and/or modify
 * it under the terms of the GNU General Public License version 2 and
 * only version 2 as published by the Free Software Foundation.
 *
 * This program is distributed in the hope that it will be useful,
 * but WITHOUT ANY WARRANTY; without even the implied warranty of
 * MERCHANTABILITY or FITNESS FOR A PARTICULAR PURPOSE. See the
 * GNU General Public License for more details.
 */

&mdss_mdp {
	dsi_r63315_tianma_tm_fhd: qcom,mdss_dsi_r63315_tianma_tm_fhd_video {
		qcom,cont-splash-enabled;
		qcom,mdss-dsi-panel-name = "LCD_TYPE_1080P_4055505";
		qcom,mdss-dsi-panel-controller = <&mdss_dsi0>;
		qcom,mdss-dsi-panel-type = "dsi_video_mode";
		qcom,mdss-dsi-panel-destination = "display_1";
		qcom,mdss-dsi-panel-framerate = <60>;
		qcom,mdss-dsi-virtual-channel-id = <0>;
		qcom,mdss-dsi-stream = <0>;
		qcom,mdss-dsi-panel-width = <1080>;
		qcom,mdss-dsi-panel-height = <1920>;
		qcom,mdss-dsi-h-front-porch = <96>;
		qcom,mdss-dsi-h-back-porch = <45>;
		qcom,mdss-dsi-h-pulse-width = <15>;
		qcom,mdss-dsi-h-sync-skew = <0>;
		qcom,mdss-dsi-v-front-porch = <6>;
		qcom,mdss-dsi-v-back-porch = <4>;
		qcom,mdss-dsi-v-pulse-width = <2>;
		qcom,mdss-dsi-h-left-border = <0>;
		qcom,mdss-dsi-h-right-border = <0>;
		qcom,mdss-dsi-v-top-border = <0>;
		qcom,mdss-dsi-v-bottom-border = <0>;
		qcom,mdss-dsi-bpp = <24>;
		qcom,mdss-dsi-underflow-color = <0xff>;
		qcom,mdss-dsi-border-color = <0>;
		qcom,mdss-dsi-pixel-packing = <0>;
		qcom,mdss-dsi-on-command = [
			29 01 00 00 00 00 02 b0 04
			29 01 00 00 00 00 02 d6 01
			29 01 00 00 00 00 07 B8 07 90 1E 10 1E 32
			29 01 00 00 00 00 07 B9 07 82 3C 10 3C 87
			29 01 00 00 00 00 07 BA 07 78 64 10 64 B4
			29 01 00 00 00 00 1A D3 1B 33 BB BB B3 33 33 33 00 01 00 A0 C8 A0 0D 46 46 33 3B 37 72 57 3D BF 33
			29 01 00 00 00 00 1F C7 00 11 19 22 30 3E 48 58 3E 47 54 62 6C 74 76 00 11 19 22 30 3E 48 58 3E 47 54 62 6C 74 76
			29 01 00 00 00 00 14 C8 01 00 01 00 03 FC 00 00 01 00 FF B4 00 00 00 03 09 E7 00
			29 01 00 00 00 00 21 CA 01 80 DC F0 D0 F0 D0 F0 08 08 14 8A 0A 4A 37 A0 55 F8 0C 0C 20 10 3F 3F 19 D6 10 10 3F 3F 3F 3F
			39 01 00 00 00 00 02 35 00
			39 01 00 00 00 00 02 36 00
			39 01 00 00 00 00 02 51 00
			39 01 00 00 00 00 02 53 24
			05 01 00 00 78 00 02 11 00
		];
		qcom,mdss-dsi-off-command = [
			05 01 00 00 14 00 02 28 00
			29 01 00 00 14 00 1A D3 13 33 BB B3 B3 33 33 33 00 01 00 A0 C8 A0 0D 46 46 33 3B 37 72 57 3D BF 33
			05 01 00 00 78 00 02 10 00
		];
		cm,mdss-livedisplay-cabc-cmd = [
			29 01 00 00 00 00 02 55 00
		];
		cm,mdss-livedisplay-cabc-ui-value = <1>;
		cm,mdss-livedisplay-cabc-image-value = <2>;
		cm,mdss-livedisplay-cabc-video-value = <3>;
		cm,mdss-livedisplay-color-enhance-on = [
			29 01 00 00 00 00 02 81 81
		];
		cm,mdss-livedisplay-color-enhance-off = [
			29 01 00 00 00 00 02 81 00
		];
		cm,mdss-livedisplay-post-cmd = [
			05 01 00 00 14 00 02 29 00
		];
		qcom,panel-backlight-response-curve = [
			00 01 02 03 04 05 05 05
			05 05 05 05 06 07 08 08
			09 09 0A 0A 0B 0B 0C 0C
			0C 0C 0C 0C 0C 0C 0C 0C
			0D 0D 0D 0D 0E 0E 0E 0E
			0E 0F 0F 10 11 12 12 13
			14 15 15 16 17 18 18 19
			1A 1B 1B 1C 1D 1D 1E 1F
			21 21 21 22 23 23 24 25
			26 26 27 27 28 28 29 29
			2A 2A 2A 2B 2B 2B 2C 2C
			2C 2D 2D 2D 2E 2E 2F 2F
			2F 30 30 31 31 31 32 33
			34 35 37 38 3A 3B 3D 3E
			3F 40 41 42 43 44 45 46
			47 48 49 4A 4B 4C 4D 4E
			4F 50 51 51 52 53 54 54
			55 56 57 57 58 59 5A 5B
			5C 5E 5F 61 62 64 65 67
			68 6A 6B 6C 6E 6F 71 72
			74 75 77 78 7A 7B 7D 7E
			7F 81 82 84 85 87 89 8B
			8C 8D 8E 90 91 92 94 95
			97 98 9A 9B 9D 9E A0 A1
			A3 A4 A5 A7 A8 AA AB AD
			AE AF B1 B3 B4 B5 B7 B8
			BA BB BD BE BF C1 C4 C5
			C7 C8 C9 CA CB CD CE D0
			D1 D3 D4 D6 D7 D9 DA DB
			DD DE E0 E1 E3 E4 E6 E7
			E8 E9 EA EA EB EB EC EC
			ED EE EF F0 F1 F2 F3 F4
		];
		qcom,mdss-dsi-on-command-state = "dsi_lp_mode";
		qcom,mdss-dsi-off-command-state = "dsi_hs_mode";
		/*
		qcom,panel-alive-reg-content = [
				0A 01 9C
				0B 01 00
				0D 01 00
		];
		*/
		qcom,mdss-dsi-panel-status-command = [06 01 00 01 05 00 02 0A 08];
		qcom,mdss-dsi-panel-status-command-state = "dsi_lp_mode";
		qcom,mdss-dsi-panel-status-check-mode = "reg_read";
		qcom,mdss-dsi-traffic-mode = "burst_mode";
		qcom,mdss-dsi-bllp-eof-power-mode;
		qcom,mdss-dsi-bllp-power-mode;
		qcom,mdss-dsi-lane-0-state;
		qcom,mdss-dsi-lane-1-state;
		qcom,mdss-dsi-lane-2-state;
		qcom,mdss-dsi-lane-3-state;
		qcom,mdss-dsi-panel-timings = [E7 36 24 00 66 6A 2A 3A 2D 03 04 00];
		qcom,mdss-dsi-t-clk-post = <0x20>;
		qcom,mdss-dsi-t-clk-pre = <0x2C>;
		qcom,mdss-dsi-bl-min-level = <1>;
		qcom,mdss-dsi-bl-max-level = <255>;
		qcom,mdss-dsi-dma-trigger = "trigger_sw";
		qcom,mdss-dsi-mdp-trigger = "none";
		qcom,mdss-dsi-bl-pmic-control-type = "bl_ctrl_dcs";
		qcom,mdss-dsi-reset-sequence = <1 10>, <0 20>, <1 20>;
		qcom,mdss-pan-physical-width-dimension = <68>;
		qcom,mdss-pan-physical-height-dimension = <121>;
		qcom,mdss-dsi-lp11-init;
		qcom,mdss-dsi-init-delay-us = <200>;
	};
};
