/* Copyright (c) 2013, The Linux Foundation. All rights reserved.
 *
 * This program is free software; you can redistribute it and/or modify
 * it under the terms of the GNU General Public License version 2 and
 * only version 2 as published by the Free Software Foundation.
 *
 * This program is distributed in the hope that it will be useful,
 * but WITHOUT ANY WARRANTY; without even the implied warranty of
 * MERCHANTABILITY or FITNESS FOR A PARTICULAR PURPOSE.  See the
 * GNU General Public License for more details.
 */

/*---------------------------------------------------------------------------
 * This file is autogenerated file using gcdb parser. Please do not edit it.
 * Update input XML file to add a new entry or update variable in this file
 * VERSION = "1.0"
 *---------------------------------------------------------------------------*/
/*
 Date            Author          IC                Module        Why
2015-04-24      xingbin      nt35521			  dijing      add dijing lcd for QL790
2015-04-24       xingbin     nt35521           	  dijing	  add code version for QL790
2015-05-18      xingbin     nt35521           	  dijing   	 modify proch for  TCLK-TRAIL
2015-06-01	   lihuiqin     nt35521h		      dijing	 update lcd parameter for vendor's require
2015-06-16	   wangjiao     nt35521h		      dijing	 modify lcd parameter for QL790
2015-07-03 	   wangjiao		nt35521h		      dijing     modify lcd Gamma parameter for QL790
2015-07-20 	   wangjiao		nt35521h		      dijing     modify lcd VGL Voltage for band
 */
&mdss_mdp {
	nt35521_dijing_4p7inch_hd_vid: qcom,mdss_dijing_nt35521_4p7inch_video {
		qcom,mdss-dsi-panel-name = "nt35521_dijing_4p7inch_hd_video_panel";
		qcom,mdss-dsi-panel-code-version="_20150720";
		qcom,mdss-dsi-panel-supply = <1>; //primary:1 second:2
		qcom,mdss-dsi-panel-controller = <&mdss_dsi0>;
		qcom,mdss-dsi-panel-type = "dsi_video_mode";
		qcom,mdss-dsi-panel-destination = "display_1";
		qcom,mdss-dsi-panel-framerate = <60>;
		qcom,mdss-dsi-virtual-channel-id = <0>;
		qcom,mdss-dsi-stream = <0>;
		qcom,mdss-dsi-panel-width = <720>;
		qcom,mdss-dsi-panel-height = <1280>;
		qcom,mdss-dsi-h-front-porch = <60>;
		qcom,mdss-dsi-h-back-porch = <60>;
		qcom,mdss-dsi-h-pulse-width = <12>;
		qcom,mdss-dsi-h-sync-skew = <0>;
		qcom,mdss-dsi-v-front-porch = <16>;
		qcom,mdss-dsi-v-back-porch = <16>;
		qcom,mdss-dsi-v-pulse-width = <2>;
		qcom,mdss-dsi-h-left-border = <0>;
		qcom,mdss-dsi-h-right-border = <0>;
		qcom,mdss-dsi-v-top-border = <0>;
		qcom,mdss-dsi-v-bottom-border = <0>;
		qcom,mdss-dsi-bpp = <24>;
		qcom,mdss-dsi-color-order = <0>;
		qcom,mdss-dsi-underflow-color = <0xff>;
		qcom,mdss-dsi-border-color = <0>;
		qcom,mdss-dsi-pixel-packing = <0>;
		qcom,mdss-dsi-on-command = [
		39 01 00 00 00 00 06 F0 55 AA 52 08 00
		39 01 00 00 00 00 05 FF AA 55 A5 80
		39 01 00 00 00 00 03 6F 11 00
		39 01 00 00 00 00 03 F7 20 00
		39 01 00 00 00 00 02 6F 01
		39 01 00 00 00 00 02 B1 21
		39 01 00 00 00 00 02 C8 80
		39 01 00 00 00 00 04 D9 00 01 4C
		39 01 00 00 00 00 06 BD 01 A0 0C 08 01
		39 01 00 00 00 00 02 6F 02
		39 01 00 00 00 00 02 B8 0C
		39 01 00 00 00 00 03 BB 11 11
		39 01 00 00 00 00 03 BC 00 00
		39 01 00 00 00 00 02 B6 01
		39 01 00 00 00 00 06 F0 55 AA 52 08 01
		39 01 00 00 00 00 03 B0 0A 0A
		39 01 00 00 00 00 03 B1 0A 0A
		39 01 00 00 00 00 03 BC A0 00
		39 01 00 00 00 00 03 BD A0 00
		39 01 00 00 00 00 02 CA 00
		39 01 00 00 00 00 02 C0 04
		39 01 00 00 00 00 03 B5 03 03
		39 01 00 00 00 00 02 BE 7A
		39 01 00 00 00 00 03 B3 28 28
		39 01 00 00 00 00 03 B4 1C 1C
		39 01 00 00 00 00 03 B8 05 05
		39 01 00 00 00 00 03 B9 36 36
		39 01 00 00 00 00 03 BA 15 15
		39 01 00 00 00 00 06 F0 55 AA 52 08 02
		39 01 00 00 00 00 02 EE 01
		39 01 00 00 00 00 11 B0 00 00 00 09 00 1D 00 32 00 41 00 61 00 7E 00 A7
		39 01 00 00 00 00 11 B1 00 C8 01 01 01 33 01 84 01 C7 01 C9 02 06 02 4C
		39 01 00 00 00 00 11 B2 02 73 02 AC 02 CD 03 01 03 1B 03 44 03 5F 03 78
		39 01 00 00 00 00 05 B3 03 DF 03 FF
		39 01 00 00 00 00 02 6F 02
		39 01 00 00 00 00 02 F7 47
		39 01 00 00 00 00 02 6F 0A
		39 01 00 00 00 00 02 F7 02
		39 01 00 00 00 00 02 6F 17
		39 01 00 00 00 00 02 F4 70
		39 01 00 00 00 00 02 6F 11
		39 01 00 00 00 00 02 F3 01
		39 01 00 00 00 00 06 F0 55 AA 52 08 06
		39 01 00 00 00 00 03 B0 2D 2E
		39 01 00 00 00 00 03 B1 29 2A
		39 01 00 00 00 00 03 B2 16 18
		39 01 00 00 00 00 03 B3 10 12
		39 01 00 00 00 00 03 B4 00 31
		39 01 00 00 00 00 03 B5 31 31
		39 01 00 00 00 00 03 B6 31 02
		39 01 00 00 00 00 03 B7 31 31
		39 01 00 00 00 00 03 B8 31 31
		39 01 00 00 00 00 03 B9 31 31
		39 01 00 00 00 00 03 BA 31 31
		39 01 00 00 00 00 03 BB 31 31
		39 01 00 00 00 00 03 BC 31 31
		39 01 00 00 00 00 03 BD 03 31
		39 01 00 00 00 00 03 BE 31 31
		39 01 00 00 00 00 03 BF 31 01
		39 01 00 00 00 00 03 C0 13 11
		39 01 00 00 00 00 03 C1 19 17
		39 01 00 00 00 00 03 C2 2A 29
		39 01 00 00 00 00 03 C3 2E 2D
		39 01 00 00 00 00 03 E5 31 31
		39 01 00 00 00 00 03 C4 2E 2D
		39 01 00 00 00 00 03 C5 29 2A
		39 01 00 00 00 00 03 C6 13 11
		39 01 00 00 00 00 03 C7 19 17
		39 01 00 00 00 00 03 C8 03 31
		39 01 00 00 00 00 03 C9 31 31
		39 01 00 00 00 00 03 CA 31 01
		39 01 00 00 00 00 03 CB 31 31
		39 01 00 00 00 00 03 CC 31 31
		39 01 00 00 00 00 03 CD 31 31
		39 01 00 00 00 00 03 CE 31 31
		39 01 00 00 00 00 03 CF 31 31
		39 01 00 00 00 00 03 D0 31 31
		39 01 00 00 00 00 03 D1 00 31
		39 01 00 00 00 00 03 D2 31 31
		39 01 00 00 00 00 03 D3 31 02
		39 01 00 00 00 00 03 D4 16 18
		39 01 00 00 00 00 03 D5 10 12
		39 01 00 00 00 00 03 D6 2A 29
		39 01 00 00 00 00 03 D7 2D 2E
		39 01 00 00 00 00 03 E6 31 31
		39 01 00 00 00 00 06 D8 00 00 00 00 00
		39 01 00 00 00 00 06 D9 00 00 00 00 00
		39 01 00 00 00 00 02 E7 00
		39 01 00 00 00 00 06 F0 55 AA 52 08 05
		39 01 00 00 00 00 02 ED 30
		39 01 00 00 00 00 06 F0 55 AA 52 08 03
		39 01 00 00 00 00 03 B1 20 00
		39 01 00 00 00 00 03 B0 20 00
		39 01 00 00 00 00 06 F0 55 AA 52 08 05
		39 01 00 00 00 00 02 E5 00
		39 01 00 00 00 00 06 F0 55 AA 52 08 05
		39 01 00 00 00 00 03 B0 17 06
		39 01 00 00 00 00 02 B8 00
		39 01 00 00 00 00 03 B1 17 06
		39 01 00 00 00 00 03 B9 00 03
		39 01 00 00 00 00 03 B2 17 06
		39 01 00 00 00 00 03 BA 00 00
		39 01 00 00 00 00 03 B3 17 06
		39 01 00 00 00 00 03 BB 02 03
		39 01 00 00 00 00 03 B4 17 06
		39 01 00 00 00 00 03 B5 17 06
		39 01 00 00 00 00 03 B6 17 06
		39 01 00 00 00 00 03 B7 17 06
		39 01 00 00 00 00 03 BC 02 03
		39 01 00 00 00 00 02 E5 06
		39 01 00 00 00 00 02 E6 06
		39 01 00 00 00 00 02 E7 00
		39 01 00 00 00 00 02 E8 06
		39 01 00 00 00 00 02 E9 06
		39 01 00 00 00 00 02 EA 06
		39 01 00 00 00 00 02 EB 00
		39 01 00 00 00 00 02 EC 00
		39 01 00 00 00 00 06 F0 55 AA 52 08 05
		39 01 00 00 00 00 02 C0 0A
		39 01 00 00 00 00 02 C1 08
		39 01 00 00 00 00 02 C2 A6
		39 01 00 00 00 00 02 C3 05
		39 01 00 00 00 00 06 F0 55 AA 52 08 03
		39 01 00 00 00 00 06 B2 04 00 86 00 00
		39 01 00 00 00 00 06 B3 04 00 86 00 00
		39 01 00 00 00 00 06 B4 04 00 17 00 00
		39 01 00 00 00 00 06 B5 04 00 17 00 00
		39 01 00 00 00 00 06 F0 55 AA 52 08 05
		39 01 00 00 00 00 02 C4 00
		39 01 00 00 00 00 02 C5 02
		39 01 00 00 00 00 02 C6 22
		39 01 00 00 00 00 02 C7 03
		39 01 00 00 00 00 06 F0 55 AA 52 08 03
		39 01 00 00 00 00 06 B6 02 00 19 00 00
		39 01 00 00 00 00 06 B7 02 00 19 00 00
		39 01 00 00 00 00 06 B8 02 00 19 00 00
		39 01 00 00 00 00 06 B9 02 00 19 00 00
		39 01 00 00 00 00 06 F0 55 AA 52 08 05
		39 01 00 00 00 00 03 C8 06 20
		39 01 00 00 00 00 03 C9 02 20
		39 01 00 00 00 00 03 CA 01 60
		39 01 00 00 00 00 03 CB 01 60
		39 01 00 00 00 00 06 F0 55 AA 52 08 03
		39 01 00 00 00 00 06 BA 44 00 86 00 00
		39 01 00 00 00 00 06 BB 44 00 86 00 00
		39 01 00 00 00 00 06 BC 44 00 1A 00 00
		39 01 00 00 00 00 06 BD 44 00 1A 00 00
		39 01 00 00 00 00 06 F0 55 AA 52 08 05
		39 01 00 00 00 00 06 D1 00 05 01 07 10
		39 01 00 00 00 00 06 D2 10 05 05 03 10
		39 01 00 00 00 00 06 D3 20 00 43 07 10
		39 01 00 00 00 00 06 D4 30 00 43 07 10
		39 01 00 00 00 00 06 F0 55 AA 52 08 05
		39 01 00 00 00 00 08 D0 00 00 00 00 00 00 00
		39 01 00 00 00 00 0c D5 00 00 00 00 00 00 00 00 00 00 00
		39 01 00 00 00 00 0c D6 00 00 00 00 00 00 00 00 00 00 00
		39 01 00 00 00 00 0c D7 00 00 00 00 00 00 00 00 00 00 00
		39 01 00 00 00 00 06 D8 00 00 00 00 00
		39 01 00 00 00 00 06 F0 55 AA 52 08 05
		39 01 00 00 00 00 04 CC 00 00 3C
		39 01 00 00 00 00 04 CD 00 00 3C
		39 01 00 00 00 00 04 CE 00 00 3C
		39 01 00 00 00 00 04 CF 00 00 3C
		39 01 00 00 00 00 06 F0 55 AA 52 08 03
		39 01 00 00 00 00 05 C0 00 34 00 00
		39 01 00 00 00 00 05 C1 00 00 34 00
		39 01 00 00 00 00 05 C2 00 00 34 00
		39 01 00 00 00 00 05 C3 00 00 34 00
		39 01 00 00 00 00 06 F0 55 AA 52 08 03
		39 01 00 00 00 00 02 C4 60
		39 01 00 00 00 00 02 C5 C0
		39 01 00 00 00 00 02 C6 00
		39 01 00 00 00 00 02 C7 00
		39 01 00 00 00 00 02 6F 01
		39 01 00 00 00 00 02 F9 46
		39 01 00 00 00 00 06 F0 55 AA 52 08 00
		05 01 00 00 78 00 02 11 00
		05 01 00 00 14 00 02 29 00
		15 01 00 00 01 00 02 53 2c
		];
		qcom,mdss-dsi-off-command = [
		15 01 00 00 01 00 02 53 24
		05 01 00 00 14 00 02 28 00
		05 01 00 00 78 00 02 10 00
		];
		qcom,mdss-dsi-on-command-state = "dsi_lp_mode";
		qcom,mdss-dsi-off-command-state = "dsi_lp_mode";
		qcom,mdss-dsi-lp11-init;
		qcom,mdss-dsi-h-sync-pulse = <1>;
		qcom,mdss-dsi-traffic-mode = <2>;
		qcom,mdss-dsi-lane-map = <0>;
		qcom,mdss-dsi-bllp-eof-power-mode;
		qcom,mdss-dsi-bllp-power-mode;
		qcom,mdss-dsi-lane-0-state;
		qcom,mdss-dsi-lane-1-state;
		qcom,mdss-dsi-lane-2-state;
		qcom,mdss-dsi-lane-3-state;
		qcom,mdss-dsi-panel-timings = [76 1A 10 00 3C 3E 14 1C 12 03 04 00];
		qcom,mdss-dsi-t-clk-post = <0x04>;
		qcom,mdss-dsi-t-clk-pre = <0x19>;
		qcom,mdss-dsi-bl-min-level = <0>;
		qcom,mdss-dsi-bl-max-level = <255>;
		qcom,mdss-dsi-dma-trigger = <4>;
		qcom,mdss-dsi-mdp-trigger = <0>;
		qcom,mdss-pan-bl-levels = <1 255>;
		qcom,mdss-dsi-bl-pmic-control-type = "bl_ctrl_dcs";
		qcom,mdss-dsi-bl-pmic-bank-select = <3>;
		qcom,mdss-dsi-bl-pmic-pwm-frequency = <270>;
		qcom,mdss-dsi-pwm-gpio = <&pm8916_gpios 6 0>;
		qcom,mdss-dsi-reset-sequence = <1 10>, <0 10>, <1 120>;
	};
};

