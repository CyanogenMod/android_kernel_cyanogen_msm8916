/* Copyright (c) 2013, The Linux Foundation. All rights reserved.
 *
 * This program is free software; you can redistribute it and/or modify
 * it under the terms of the GNU General Public License version 2 and
 * only version 2 as published by the Free Software Foundation.
 *
 * This program is distributed in the hope that it will be useful,
 * but WITHOUT ANY WARRANTY; without even the implied warranty of
 * MERCHANTABILITY or FITNESS FOR A PARTICULAR PURPOSE.  See the
 * GNU General Public License for more details.
 */

/*---------------------------------------------------------------------------
 * This file is autogenerated file using gcdb parser. Please do not edit it.
 * Update input XML file to add a new entry or update variable in this file
 * VERSION = "1.0"
 *---------------------------------------------------------------------------*/
&mdss_mdp {
	dsi_txd_hx8394d_720p_video: qcom,mdss_dsi_txd_hx8394d_720p_video {
		qcom,mdss-dsi-panel-name = "txd_hx8394d_HD720p_video";
		qcom,mdss-dsi-panel-controller = <&mdss_dsi0>;
		qcom,mdss-dsi-panel-type = "dsi_video_mode";
		qcom,mdss-dsi-panel-destination = "display_1";
		qcom,mdss-dsi-panel-framerate = <58>;
		qcom,mdss-dsi-virtual-channel-id = <0>;
		qcom,mdss-dsi-stream = <0>;
		qcom,mdss-dsi-panel-width = <720>;
		qcom,mdss-dsi-panel-height = <1280>;
		qcom,mdss-dsi-h-front-porch = <100>;
		qcom,mdss-dsi-h-back-porch = <100>;
		qcom,mdss-dsi-h-pulse-width = <20>;
		qcom,mdss-dsi-h-sync-skew = <0>;
		qcom,mdss-dsi-v-back-porch = <16>;
		qcom,mdss-dsi-v-front-porch = <9>;
		qcom,mdss-dsi-v-pulse-width = <2>;
		qcom,mdss-dsi-h-left-border = <0>;
		qcom,mdss-dsi-h-right-border = <0>;
		qcom,mdss-dsi-v-top-border = <0>;
		qcom,mdss-dsi-v-bottom-border = <0>;
		qcom,mdss-dsi-bpp = <24>;
		qcom,mdss-dsi-color-order = "rgb_swap_rgb";
		qcom,mdss-dsi-underflow-color = <0xff>;
		qcom,mdss-dsi-border-color = <0>;
		qcom,mdss-dsi-on-command = [39 01 00 00 00 00 04 B9 FF 83 94
			39 01 00 00 00 00 03 BA 73 83
			39 01 00 00 00 00 10 B1 6A 15 15 13 04 11 F1 80 EC 55 23 80 C0 D2 58
			39 01 00 00 00 00 0C B2 00 64 10 07 12 1C 08 08 1C 4D 00
			39 01 00 00 00 00 0D B4 00 FF 03 5A 03 5A 03 5A 01 6a 01 6a
			39 01 00 00 00 00 02 BC 07
			39 01 00 00 00 00 02 D2 55
			39 01 00 00 00 00 1F D3 00 0F 00 40 1A 08 00 32 10 07 00 07 54 15 0F 05 04 02 12 10 05 07 33 33 0B 0B 37 10 07 07
			39 01 00 00 00 00 2D D5 19 19 18 18 1B 1B 1A 1A 04 05 06 07 00 01 02 03 20 21 18 18 22 23 18 18 18 18 18 18 18 18 18 18 18 18 18 18 18 18 18 18 18 18 18 18
			39 01 00 00 00 00 2D D6 18 18 19 19 1B 1B 1A 1A 03 02 01 00 07 06 05 04 23 22 18 18 21 20 18 18 18 18 18 18 18 18 18 18 18 18 18 18 18 18 18 18 18 18 18 18
			39 01 00 00 00 00 03 B6 80 80
			39 01 00 00 00 00 2B E0 00 03 09 2D 33 3F 16 38 06 0A 0C 18 0D 11 13 11 11 06 10 12 16 00 03 09 2D 33 3f 16 38 06 0A 0C 18 0D 11 13 11 11 06 10 12 16
			39 01 00 00 00 00 02 BD 00
			39 01 00 00 00 00 2C C1 01 00 08 0F 16 1D 24 2C 34 3B 41 46 4C 54 5C 64 6B 72 79 80 86 8D 95 9C A2 A8 AF B6 BD C4 CC D4 DA E0 15 69 0A A4 03 C1 90 A2 C0
			39 01 00 00 00 00 02 BD 01
			39 01 00 00 00 00 2B C1 00 08 0F 16 1D 24 2C 34 3B 41 46 4C 54 5C 64 6B 72 79 80 86 8D 95 9C A2 A8 AF B6 BD C4 CC D4 DA E0 15 69 0A A4 03 C1 90 A2 C0
			39 01 00 00 00 00 02 BD 02
			39 01 00 00 00 00 2B C1 00 09 11 19 21 29 33 3A 41 48 4F 59 61 69 71 79 81 89 91 99 A0 A8 AF B7 C0 C8 D1 D9 E0 E7 EF F7 FF 14 B3 CC FE 97 CE 21 76 C0
			39 01 00 00 0A 00 03 E4 01 01
			39 01 00 00 00 00 03 C0 30 14
			39 01 00 00 00 00 05 C7 00 C0 00 C0
			39 01 00 00 00 00 02 CC 05
			39 01 00 00 00 00 02 DF 88
			05 01 00 00 78 00 02 11 00
			05 01 00 00 00 00 02 29 00];
		qcom,mdss-dsi-off-command = [05 01 00 00 32 00 02 28 00
			05 01 00 00 78 00 02 10 00];
		qcom,mdss-dsi-on-command-state = "dsi_lp_mode";
		qcom,mdss-dsi-off-command-state = "dsi_hs_mode";
		qcom,mdss-dsi-h-sync-pulse = <1>;
		qcom,mdss-dsi-traffic-mode = "burst_mode";
		qcom,mdss-dsi-lane-map = "lane_map_0123";
		qcom,mdss-dsi-bllp-eof-power-mode;
		qcom,mdss-dsi-bllp-power-mode;
		qcom,mdss-dsi-lane-0-state;
		qcom,mdss-dsi-lane-1-state;
		qcom,mdss-dsi-lane-2-state;
		qcom,mdss-dsi-lane-3-state;
		qcom,mdss-dsi-panel-timings = [7B 1A 10 00 3E 40 16 1C 15 03 04 00];
		qcom,mdss-dsi-t-clk-post = <0x04>;
		qcom,mdss-dsi-t-clk-pre = <0x1A>;
		qcom,mdss-dsi-bl-min-level = <1>;
		qcom,mdss-dsi-bl-max-level = <255>;
		qcom,mdss-dsi-bl-pmic-pwm-frequency = <100>;
		qcom,mdss-dsi-bl-pmic-bank-select = <0>;
		qcom,mdss-dsi-dma-trigger = "trigger_sw";
		qcom,mdss-dsi-mdp-trigger = "none";
		qcom,mdss-dsi-bl-pmic-control-type = "bl_ctrl_pwm";
		qcom,mdss-dsi-reset-sequence = <1 20>, <0 10>, <1 100>;
		qcom,mdss-dsi-lp11-init;
		qcom,suspend-ulps-enabled;
	};
};
