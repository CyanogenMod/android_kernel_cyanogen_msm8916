/* Copyright (c) 2013, The Linux Foundation. All rights reserved.
 *
 * This program is free software; you can redistribute it and/or modify
 * it under the terms of the GNU General Public License version 2 and
 * only version 2 as published by the Free Software Foundation.
 *
 * This program is distributed in the hope that it will be useful,
 * but WITHOUT ANY WARRANTY; without even the implied warranty of
 * MERCHANTABILITY or FITNESS FOR A PARTICULAR PURPOSE.  See the
 * GNU General Public License for more details.
 */

/*---------------------------------------------------------------------------
 * This file is autogenerated file using gcdb parser. Please do not edit it.
 * Update input XML file to add a new entry or update variable in this file
 * VERSION = "1.0"
 *---------------------------------------------------------------------------*/
&mdss_mdp {
	dsi_truly_otm1288a_720p_video_vid: qcom,mdss_dsi_truly_otm1288a_720p_video {
		qcom,mdss-dsi-panel-name = "TRULY OTM1288A video mode dsi panel";
		qcom,mdss-dsi-panel-controller = <&mdss_dsi0>;
		qcom,mdss-dsi-panel-type = "dsi_video_mode";
		qcom,mdss-dsi-panel-destination = "display_1";
		qcom,cont-splash-enabled;
		qcom,mdss-dsi-panel-framerate = <60>;
		qcom,mdss-dsi-virtual-channel-id = <0>;
		qcom,mdss-dsi-stream = <0>;
		qcom,mdss-dsi-panel-width = <720>;
		qcom,mdss-dsi-panel-height = <1280>;
		qcom,mdss-dsi-h-front-porch = <44>;
		qcom,mdss-dsi-h-back-porch = <42>;
		qcom,mdss-dsi-h-pulse-width = <6>;
		qcom,mdss-dsi-h-sync-skew = <0>;
		qcom,mdss-dsi-v-front-porch = <16>;
		qcom,mdss-dsi-v-back-porch = <14>;
		qcom,mdss-dsi-v-pulse-width = <2>;
		qcom,mdss-dsi-h-left-border = <0>;
		qcom,mdss-dsi-h-right-border = <0>;
		qcom,mdss-dsi-v-top-border = <0>;
		qcom,mdss-dsi-v-bottom-border = <0>;
		qcom,mdss-dsi-bpp = <24>;
		qcom,mdss-dsi-color-order = "rgb_swap_rgb";
		qcom,mdss-dsi-underflow-color = <0xff>;
		qcom,mdss-dsi-border-color = <0>;
		qcom,mdss-pan-physical-width-dimension = <62>; //the panel physical size : refer to datasheet
		qcom,mdss-pan-physical-height-dimension = <111>;
		qcom,mdss-dsi-on-command = [
			23 01 00 00 00 00 02
			00 00
			29 01 00 00 00 00 04
			ff 12 88 01
			23 01 00 00 00 00 02
			00 80
			29 01 00 00 00 00 03
			ff 12 88
			23 01 00 00 00 00 02
			00 80
			29 01 00 00 00 00 0A
			c0 00 64 00 10 10 00
			64 10 10
			23 01 00 00 00 00 02
			00 90 
			29 01 00 00 00 00 07
			c0 00 00 00 14 00 1b
			//set video mode
			23 01 00 00 00 00 02
			00 00  
			23 01 00 00 00 00 02
			1C 32
			//end
			23 01 00 00 00 00 02
			00 A3 
			23 01 00 00 00 00 02
			c0 25 
			23 01 00 00 00 00 02
			00 b3 
			23 01 00 00 00 00 02
			c0 00        
			23 01 00 00 00 00 02
			00 80
			23 01 00 00 00 00 02
			c4 43
			23 01 00 00 00 00 02
			00 a2
			23 01 00 00 00 00 02
			c1 41
			23 01 00 00 00 00 02
			00 b6
			23 01 00 00 00 00 02
			b0 18
			//configure 4 lane
			23 01 00 00 00 00 02
			00 92
			29 01 00 00 00 00 03
			FF 30 02
			//end
			23 01 00 00 00 00 02
			00 80
			23 01 00 00 00 00 02
			c5 53
			23 01 00 00 00 00 02
			00 93
			23 01 00 00 00 00 02
			c5 66
			23 01 00 00 00 00 02
			00 a0 
			29 01 00 00 00 00 0F
			c4 05 10 06 02 05 15
			10 05 10 07 02 05 15
			10
			23 01 00 00 00 00 02
			00 b0
			29 01 00 00 00 00 04
			c4 00 00 03
			23 01 00 00 00 00 02
			00 91
			29 01 00 00 00 00 03
			c5 3d A6
			23 01 00 00 00 00 02
			00 c2
			23 01 00 00 00 00 02
			c5 b1
			23 01 00 00 00 00 02
			00 e1
			23 01 00 00 00 00 02
			f5 55
			23 01 00 00 00 00 02
			00 c2
			29 01 00 00 00 00 03
			f5 00 00
			23 01 00 00 00 00 02
			00 c4
			29 01 00 00 00 00 03
			f5 00 00
			23 01 00 00 00 00 02
			00 c6
			29 01 00 00 00 00 03
			f5 00 00
			23 01 00 00 00 00 02
			00 f3 
			23 01 00 00 00 00 02
			cf 34
			23 01 00 00 00 00 02
			00 83
			23 01 00 00 00 00 02
			c5 30
			23 01 00 00 00 00 02
			00 00
			23 01 00 00 00 00 02
			d0 40
			23 01 00 00 00 00 02
			00 00
			29 01 00 00 00 00 03
			d1 00 00
			23 01 00 00 00 00 02
			00 80
			29 01 00 00 00 00 0C
			cb 00 00 00 00 00 00
			00 00 00 00 00
			23 01 00 00 00 00 02
			00 90
			29 01 00 00 00 00 10
			cb 00 00 00 00 00 00
			00 00 00 00 00 00 00
			00 00
			23 01 00 00 00 00 02
			00 a0
			29 01 00 00 00 00 10
			cb 00 00 00 00 00 00
			00 00 00 00 00 00 00
			00 00
			23 01 00 00 00 00 02
			00 b0
			29 01 00 00 00 00 10
			cb 00 00 00 00 00 00
			00 00 00 00 00 00 00
			00 00
			23 01 00 00 00 00 02
			00 c0
			29 01 00 00 00 00 10
			cb 05 05 05 05 05 05
			05 05 05 00 05 00 00
			00 00
			23 01 00 00 00 00 02
			00 d0
			29 01 00 00 00 00 10
			cb 00 00 00 00 05 00
			00 05 05 05 05 05 05
			05 05
			23 01 00 00 00 00 02
			00 e0
			29 01 00 00 00 00 0F
			cb 05 00 05 00 00 00
			00 00 00 00 00 05 00
			00
			23 01 00 00 00 00 02
			00 f0
			29 01 00 00 00 00 0C
			cb ff ff ff ff ff ff
			ff ff ff ff ff
			23 01 00 00 00 00 02
			00 80
			29 01 00 00 00 00 10
			cc 29 2a 0A 0c 0e 10
			12 14 06 00 08 00 00
			00 00
			23 01 00 00 00 00 02
			00 90
			29 01 00 00 00 00 10
			cc 00 00 00 00 02 00
			00 29 2A 09 0b 0d 0f
			11 13
			23 01 00 00 00 00 02
			00 a0
			29 01 00 00 00 00 0F
			cc 05 00 07 00 00 00
			00 00 00 00 00 01 00
			00
			23 01 00 00 00 00 02
			00 b0
			29 01 00 00 00 00 10
			cc 29 2A 13 11 0F 0D
			0B 09 01 00 07 00 00
			00 00
			23 01 00 00 00 00 02
			00 c0
			29 01 00 00 00 00 10
			cc 00 00 00 00 05 00
			00 29 2A 14 12 10 0E
			0C 0A
			23 01 00 00 00 00 02
			00 d0
			29 01 00 00 00 00 0F
			cc 02 00 08 00 00 00
			00 00 00 00 00 06 00
			00
			23 01 00 00 00 00 02
			00 80
			29 01 00 00 00 00 0D
			ce 87 05 10 86 05 10
			00 00 00 00 00 00
			23 01 00 00 00 00 02
			00 90
			29 01 00 00 00 00 0F
			ce 54 FF 10 55 00 10
			55 03 10 55 04 10 00
			00
			23 01 00 00 00 00 02
			00 a0
			29 01 00 00 00 00 0F
			ce 58 05 04 FF 00 10
			00 58 04 05 00 00 10
			00
			23 01 00 00 00 00 02
			00 b0
			29 01 00 00 00 00 0F
			ce 58 03 05 01 00 10
			00 58 02 05 02 00 10
			00
			23 01 00 00 00 00 02
			00 c0
			29 01 00 00 00 00 0F
			ce 58 01 05 03 00 10
			00 58 00 05 04 00 10
			00
			23 01 00 00 00 00 02
			00 d0
			29 01 00 00 00 00 0F
			ce 50 00 05 05 00 10
			00 50 01 05 06 00 10
			00
			23 01 00 00 00 00 02
			00 80
			29 01 00 00 00 00 0F
			cf 50 02 05 07 00 10
			00 50 03 05 08 00 10
			00
			23 01 00 00 00 00 02
			00 90
			29 01 00 00 00 00 0F
			cf 50 04 05 09 00 10
			00 50 05 05 0A 00 10
			00
			23 01 00 00 00 00 02
			00 c0
			29 01 00 00 00 00 0A
			cf 3D 20 00 00 01 00
			20 00 00
			23 01 00 00 00 00 02
			00 80
			29 01 00 00 00 00 07
			f3 00 00 00 00 00 00
			23 01 00 00 00 00 02
			00 92
			29 01 00 00 00 00 03
			F5 00 00
			23 01 00 00 00 00 02
			00 C8
			29 01 00 00 00 00 03
			F5 0B 15
			23 01 00 00 00 00 02
			00 00
			29 01 00 00 00 00 03
			D8 B6 B6
			23 01 00 00 00 00 02
			00 00
			23 01 00 00 00 00 02
			D9 80
			23 01 00 00 00 00 02
			00 00
			29 01 00 00 00 00 15
			E1 02 25 33 41 50 5E
			5F 86 74 8B 7A 66 78
			54 52 45 37 2C 27 1F
			23 01 00 00 00 00 02
			00 00
			29 01 00 00 00 00 15
			E2 02 25 33 41 50 5E
			5F 86 74 8B 7A 66 78
			54 52 45 37 2C 27 1F
			23 01 00 00 00 00 02
			00 00
			29 01 00 00 00 00 04
			FF FF FF FF

			05 01 00 00 78 00 02
			11 00
			05 01 00 00 00 00 02
			29 00
					];
		qcom,mdss-dsi-off-command = [
			05 01 00 00 32 00 02
			28 00
			05 01 00 00 78 00 02
			10 00
					];
		qcom,mdss-dsi-on-command-state = "dsi_lp_mode";
		qcom,mdss-dsi-off-command-state = "dsi_lp_mode";
		qcom,mdss-dsi-h-sync-pulse = <0>;
		qcom,mdss-dsi-traffic-mode = "non_burst_sync_pulse";
		qcom,mdss-dsi-lane-map = "lane_map_0123";
		qcom,mdss-dsi-bllp-eof-power-mode;
		qcom,mdss-dsi-bllp-power-mode;
		qcom,mdss-dsi-lane-0-state;
		qcom,mdss-dsi-lane-1-state;
		qcom,mdss-dsi-lane-2-state;
		qcom,mdss-dsi-lane-3-state;
		qcom,mdss-dsi-panel-timings = [b0 23 1b 00 94 93 1e 25 15 03 04 00];
		qcom,mdss-dsi-t-clk-post = <0x04>;
		qcom,mdss-dsi-t-clk-pre = <0x1b>;
		qcom,mdss-dsi-bl-min-level = <1>;
		qcom,mdss-dsi-bl-max-level = <4095>;
		qcom,mdss-dsi-dma-trigger = "trigger_sw";
		qcom,mdss-dsi-mdp-trigger = "none";
		qcom,mdss-dsi-bl-pmic-control-type = "bl_ctrl_pwm";
		qcom,mdss-dsi-bl-pmic-pwm-frequency = <100>;
		qcom,mdss-dsi-bl-pmic-bank-select = <0>;
		qcom,mdss-dsi-pwm-gpio = <&pm8916_mpps 4 0>;
		qcom,mdss-dsi-reset-sequence = <1 20>, <0 10>, <1 20>;

		//add lcd esd
		//qcom,mdss-dsi-panel-status-command = [06 01 00 01 05 00 02 0A 08];
		//qcom,mdss-dsi-panel-status-command-state = "dsi_lp_mode";
		//qcom,mdss-dsi-panel-status-check-mode = "reg_read";
		//qcom,mdss-dsi-panel-status-value = <0x9c>;
		//qcom,esd-check-enabled;
		//esd end
	};
};
