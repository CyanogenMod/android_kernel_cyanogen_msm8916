## drivers/sensors/alsprox/tmd277x/Kconfig
```kconfig
config YL_TMD277x_ALSPROX
	tristate "TAOS Ambient & Promixity Sensor Driver"
	depends on I2C
	default n
	help
	 TAOS Ambient & Promixity Sensor Driver implemented by YL.
	  
```

## drivers/sensors/compass/Kconfig
```kconfig
#
# sensors devices
#

menu "Compass Sensors Drivers"

config YL_SENSORS_COMPASS
        tristate "Compass Sensor Support"
        depends on I2C
        default n	
        help
          Support Compass Driver

if YL_SENSORS_COMPASS
source "drivers/sensors/compass/akm8975/Kconfig"
source "drivers/sensors/compass/bmm050/Kconfig"
source "drivers/sensors/compass/yas533/Kconfig"
endif

endmenu
```

## drivers/sensors/compass/akm8975/Kconfig
```kconfig
config YL_AKM8975_COMPASS
	tristate "akm8975 Compass Support"
    depends on I2C
    default n
	help
	  akm8975 Compass Driver
```

## drivers/sensors/compass/bmm050/Kconfig
```kconfig
config YL_BMM050_COMPASS
	tristate "BMM050 Magnetic Sensor Driver"
	depends on I2C
    default n
	help
	 BMM050 Magnetic Sensor Driver implemented by Bosch-Sensortec.
```

## drivers/sensors/compass/yas533/Kconfig
```kconfig
config YL_YAS533_COMPASS
	tristate "YAS533 Magnetic Sensor Driver"
	depends on I2C
    default n
	help
	 YAS533 Magnetic Sensor Driver implemented by Bosch-Sensortec.
```

## drivers/sensors/fingerprint/Kconfig
```kconfig
#
# sensors devices
#

menu "Fingerprint Sensors Drivers"

config YL_SENSORS_FINGERPRINT
        tristate "Fingerprint Sensor Support"
        depends on SPI_MASTER
		default n
        help
          Support Fingerprint Driver

if YL_SENSORS_FINGERPRINT
source "drivers/sensors/fingerprint/fpc1080/Kconfig"
endif

endmenu
```

## drivers/sensors/fingerprint/fpc1080/Kconfig
```kconfig
config YL_FPC1080_FINGERPRINT
	tristate "FPC1080 Fingerprint Sensor Support"
	depends on SPI_MASTER
    default n
	help
	  FPC1080 Fingerprint Sensor Driver

config FPC1080_NAVIGATION
    tristate "FPC1080 fingerprint sensor navigation support"
    depends on YL_FPC1080_FINGERPRINT
```

## drivers/sensors/gesture/Kconfig
```kconfig
#
# sensors devices
#

menu "3D Gesture Sensors Drivers"

config YL_SENSORS_GESTURE
        tristate "Gesture Sensor Support"
        depends on I2C
        default n
        help
          Support Gesture Driver

if YL_SENSORS_GESTURE
source "drivers/sensors/gesture/adux1020/Kconfig"
source "drivers/sensors/gesture/tmg399x/Kconfig"
endif

endmenu
```

## drivers/sensors/gesture/adux1020/Kconfig
```kconfig
config YL_ADUX1020_GESTURE
	tristate "adux1020 3d gesture support"
	select	AVERAGE
	depends on I2C
	default n
	help
	  adux1020 3d gesture driver
	  
```

## drivers/sensors/gesture/tmg399x/Kconfig
```kconfig
config YL_TMG399x_GESTURE
	tristate "tmg399x 3d gesture support"
	depends on I2C
	default n
	help
	  tmg399x 3d gesture driver
	  
```

## drivers/sensors/hall/Kconfig
```kconfig
config YL_SENSORS_HALL
	tristate "hall sensor" 
	help 
	  hall sensor Driver
	  
```

## drivers/sensors/humiture/Kconfig
```kconfig
#
# sensors devices
#

menu "Humiture Sensors Drivers"

config YL_SENSORS_HUMITURE
        tristate "Humiture Sensor Support"
        depends on I2C
		default n
        help
          Support Humiture Driver

if YL_SENSORS_HUMITURE
source "drivers/sensors/humiture/hshcal001a/Kconfig"
source "drivers/sensors/humiture/hts221/Kconfig"
source "drivers/sensors/humiture/bme280/Kconfig"
endif

endmenu
```

## drivers/sensors/humiture/bme280/Kconfig
```kconfig
#
# Please let upper layer's Kconfig contains BME280 Kconfig.
# For example, you can add the following statement to the end of
# drivers/input/misc/Kconfig when you think BME280 as input misc device.
#     source "drivers/input/misc/bme280/Kconfig"
#

config YL_BME280_HUMITURE
	tristate "BME280 digital pressure sensor"
	depends on (I2C || SPI_MASTER) && SYSFS
	help
	  If you say yes here you get support for Bosch Sensortec
	  digital pressure sensors BME280.

	  To compile this driver as a module, choose M here: the
	  module will be called bme280-core.

config YL_BME280_I2C_HUMITURE
	tristate "support I2C bus communication"
	depends on  I2C
	help
	  Say Y here if you want to support Bosch Sensortec digital pressure
	  sensor hooked to an I2C bus.

	  To compile this driver as a module, choose M here: the
	  module will be called bme280-i2c.

#config BME280_SPI
#	tristate "support SPI bus communication"
#	depends on BME280 && SPI_MASTER
#	help
#	  Say Y here if you want to support Bosch Sensortec digital pressure
#	  sensor hooked to an SPI bus.
#
#	  To compile this driver as a module, choose M here: the
#	  module will be called bme280-spi.
```

## drivers/sensors/humiture/hshcal001a/Kconfig
```kconfig
config YL_HSHCAL001A_DEBUG
	boolean "Debug support for ALPS Humidity drivers"
	depends on DEBUG_KERNEL
	default n
	help
	  Say "yes" to enable debug messaging.

config YL_HSHCAL001A_HUMITURE
	tristate "HSHCAL001A Humidity Sensor Driver"
	depends on I2C
	default n
	help
	  Say yes here to build support for ALPS Electric HSHCAL001A Humidity Driver.
```

## drivers/sensors/humiture/hts221/Kconfig
```kconfig
config YL_HTS221_HUMITURE
	tristate "ST HTS221 Humidity Sensor Driver"
	default n
	depends on I2C
	help
	  Say yes here to build support for ST Electric HTS221 Humidity Driver.
```

## drivers/sensors/mpu6880/Kconfig
```kconfig
############################################
## 	Kconfig for alsprox sensors devices	
																		
############################################

config YL_SENSORS_MPU6880
	tristate "invensense mpu6880 support"
	default n
	depends on I2C=y
	select INPUT_POLLDEV
	help
	  If you say yes here you get support for invensense's mpu6880
```

## drivers/sensors/pressure/Kconfig
```kconfig
#
# sensors devices
#

menu "Pressure Sensors Drivers"

config YL_SENSORS_PRESSURE
        tristate "Pressure Sensor Support"
        depends on I2C
		default n
        help
          Support Pressure Driver

if YL_SENSORS_PRESSURE
source "drivers/sensors/pressure/lps331ap/Kconfig"
source "drivers/sensors/pressure/lps25h/Kconfig"
endif

endmenu
```

## drivers/sensors/pressure/lps25h/Kconfig
```kconfig
config YL_LPS25H_PRESSURE
	tristate "LPS25H Pressure Support"
	depends on I2C=y
	help
	  LPS25H Pressure Driver
	  
```

## drivers/sensors/pressure/lps331ap/Kconfig
```kconfig
config YL_LPS331AP_PRESSURE
	tristate "LPS331AP Pressure Support"
	depends on I2C
	default n
	help
	  LPS331AP Pressure Driver
	  
```

## drivers/sensors/sensorhub/Kconfig
```kconfig
#
# sensors devices
#

menu "Sensor Hub Sensors Drivers"

config YL_SENSORS_SENSORHUB
        tristate "Sensor Hub Sensor Support"
        depends on I2C
		default n
        help
          Support Sensor Hub Driver

if YL_SENSORS_SENSORHUB
source "drivers/sensors/sensorhub/hcrest/Kconfig"
source "drivers/sensors/sensorhub/mxf0100/Kconfig"
endif

endmenu
```

## drivers/sensors/sensorhub/hcrest/Kconfig
```kconfig
comment "Hillcrest Labs Sensor Hub module"

config YL_HCREST_SENSORHUB
	tristate "Hcrest & Atmel G51 Sensor Hub Support"
	depends on I2C
	default n
	help
	  Hcrest & Atmel G51 Sensor Hub Driver

config SENSOR_HUB_CORE
	tristate "Hillcrest Labs sensor hub driver core"
	depends on I2C && SYSFS
	default n
	help
	  This module implements functionality common to all sensor hub interfaces

config SENSOR_HUB_I2C
	tristate "Hillcrest Labs sensor hub driver - I2C Interface"
	depends on I2C && SYSFS
	default n
	select SENSOR_HUB_CORE
	help
	  Select this to enable the Hillcrest Labs sensorhub driver using I2C interface

config SENSOR_HUB_SPI
	tristate "Hillcrest Labs sensor hub driver - SPI Interface"
	depends on SPI && SYSFS
	default n
	select SENSOR_HUB_CORE
	help
	  Select this to enable the Hillcrest Labs sensorhub driver using SPI interface

config SENSOR_HUB_I2C_ATMEL_DFU
	bool "Hillcrest Labs sensor hub DFU support for Atmel devices"
	depends on SENSOR_HUB_I2C && FW_LOADER
	default n
	help
	  Select this to enable firmware upgrade support for Atmel I2C devices

config SENSOR_HUB_DEBUG
	bool "Hillcrest Labs sensor hub driver debug support"
	depends on SENSOR_HUB_CORE
	default n
	help
	  Select this option to help debug the Hillcrest Labs sensor hub device.
```

## drivers/sensors/sensorhub/mxf0100/Kconfig
```kconfig
config YL_MXF0100_SENSORHUB
	tristate "Atmel mXF0100 Sensor Hub Support"
	depends on I2C
	default n
	help
	  mXF0100 Sensor Hub Driver
```

## drivers/sensors/sensparams/Kconfig
```kconfig
config YL_SENSORS_PARAMS
	tristate "sensor calibration params storage Support"
	depends on I2C
	default n
	help
	  sensor calibration params storage Driver
```
