## Documentation/devicetree/bindings/input/misc/ap3426_cm.txt
```
AP3426 3-in-1 digital ALS+PS+IRLED module

AP3426 is a module integrated with a digital ambient light sensor, a proximity
sensor, and an IR LED in a single package. It provides multiple gain ambient
light detection as well as external object distance detection. It can be
connected to host processor via i2c.

This is for the CyanogenMod version of the driver, called ap3426_cm.

Required properties:
 - compatible		: Should be "di_ap3426".
 - reg				: i2c slave address of this device.
 - vdd-supply		: Analog power supply needed to power up this device.
 - vio-supply		: Digital IO power supply needed for IO and i2c.
 - interrupt-parent	: The interrupt controler this device connected to.
 - interrupts		: L/P sample interrupt to indicate new data ready.
 - pinctrl-names	: pinctrl configuration names of this device. Should be "default" and "sleep".
 - pinctrl-0		: Should specify pin control groups used for this sensor.
 - pinctrl-1		: Should specify pin control groups used for this sensor.
 - ap3426,irq-gpio	: GPIO pin for interrupt of this device.
 - ap3426,ps-integrated-time: Selects the duration at which the device's ADC will sample the
		photodiode current signal. The maximum value is 63.
 - ap3426,ps-thdl	: Proximity sensor low threshold
 - ap3426,ps-thdh	: Proximity sensor high threshold


Optional properties:
 - ap3426,ps-calibration-min		: Minimum reading for proximity sensor calibration
 - ap3426,ps-calibration-expected	: Expected reading for proximity sensor calibration
 - ap3426,ps-calibration-max		: Maximum reading for proximity sensor calibration

Example:

&i2c_0 { /* BLSP1 QUP2 */
	di_ap3426@1e {
		compatible = "di_ap3426";
		reg = <0x1e>;
		interrupt-parent = <&msm_gpio>;
		interrupts = <113 0x2002>;
		vdd-supply = <&pm8916_l17>;
		vio-supply = <&pm8916_l6>;
		ap3426,irq-gpio= <&msm_gpio 113 0x2002>;
		ap3426,ps-thdl = <100>;
		ap3426,ps-thdh = <200>;
		ap3426,ps-calibration-min = <0>;
		ap3426,ps-calibration-expected = <120>;
		ap3426,ps-calibration-max = <500>;
		ap3426,ps-integrated-time = <0x0>;
	};
};
```

## Documentation/devicetree/bindings/input/touchscreen/himax-852xes.txt
```
Himax touch controller

The himax controller is connected to host processor
via i2c. The controller generates interrupts when the
user touches the panel. The host controller is expected
to read the touch coordinates over i2c and pass the coordinates
to the rest of the system.

Required properties:

 - compatible		: should be "himax,852xes"
 - reg			: i2c slave address of the device
 - interrupt-parent	: parent of interrupt
 - interrupts		: touch sample interrupt to indicate presense or release
				of fingers on the panel.
 - vdd-ana-supply		: Power supply needed to power up the device
 - vcc_i2c-supply	: Power source required to power up i2c bus
 - himax,irq-gpio	: irq gpio which is to provide interrupts to host,
				same as "interrupts" node. It will also
				contain active low or active high information.
 - himax,rst-gpio	: reset gpio to control the reset of chip
 - himax,display-coords : display coords in pixels. It is a four
				tuple consisting of min x, min y, max x and
				max y values
 - pinctrl-names : This should be defined if a target uses pinctrl framework.
			See "pinctrl" in Documentation/devicetree/bindings/pinctrl/msm-pinctrl.txt.
			Specify the names of the configs that pinctrl can install in driver.
			Following are the pinctrl configs that can be installed:
			"pmx_ts_active" : Active configuration of pins, this should specify active
			config defined in pin groups of interrupt and reset gpio.
			"pmx_ts_suspend" : Disabled configuration of pins, this should specify sleep
			config defined in pin groups of interrupt and reset gpio.
			"pmx_ts_release" : Release configuration of pins, this should specify
			release config defined in pin groups of interrupt and reset gpio.
 - himax,num-max-touches: It defines the maximum number of touch supported by the controller.
 - himax,hard-reset-delay-ms : hard reset delay in ms
 - himax,post-hard-reset-delay-ms : post hard reset delay in ms
 - report_type : the protocol type when TP reports, 0 means TYPE A, 1 means type B.

Optional properties:

 - himax,button-map : button map of key codes. It is a three tuple consisting of key codes.
 - himax,panel-coords : panel coords for the chip in pixels.
				It is a four tuple consisting of min x,
				min y, max x and max y values
 - himax,ic-type : It defines the ic-type of the controller. Values are as folows:

Example:
	i2c@78b9000 { /* BLSP1 QUP5 */
		himax@4a {
			compatible = "himax,852xes";
			reg = <0x4a>;
			interrupt-parent = <&msm_gpio>;
			interrupts = <13 0x2008>;
			himax,irq-gpio = <&msm_gpio 13 0x00000001>;
			himax,rst-gpio = <&msm_gpio 12 0x0>;
			vdd-ana-supply = <&pm8916_l17>;
			vcc_i2c-supply = <&pm8916_l6>;
			himax,display-coords = <0 0 480 854>;
			pinctrl-names = "pmx_ts_active","pmx_ts_suspend";
			pinctrl-0 = <&ts_int_active &ts_reset_active>;
			pinctrl-1 = <&ts_int_suspend &ts_reset_suspend>;
			himax,button-map = <172 139 158>;
			himax,ic-type = <2>;
			himax,num_max_touches = <2>;
			himax,hard-reset-delay-ms = <100>;
			himax,post-hard-reset-delay-ms = <100>;
			report_type             = <1>;
		};
	};
```

## arch/arm/mach-msm/yulong/Kconfig
```kconfig
# Yulong/Coolpad configuration options

config MACH_YULONG
	bool "Yulong device"
	depends on ARCH_MSM
	help
	  Support for Yulong products

config MACH_YULONG_MSM8939
	bool "Yulong MSM8939"
	depends on MACH_MSM8916
	select MACH_YULONG
	help
	  Support for MSM8939 Yulong variants

menu "Yulong board selection"

config MACH_CP8675
	bool "CP8675_I01 board"
	select MACH_YULONG_MSM8939
	help
	  Support for Yulong CP8675_I01 variant

endmenu

menu "Yulong debug selection"

config ANDROID_DEV_DEBUG
	bool "Android GPIO debugging support"
	help
	  GPIO debugging

config YULONG_DEBUG
	bool "Yulong debugging support"
	help
	  Yulong debugging

config YULONG_MODULE_MANAGEMENT
	bool "Yulong module management support"
	help
	  This driver provides a method for enabling/disabling a device.

config YULONG_USB_UART_SWITCH
	bool "Yulong USB UART switch support"
	help
	  This driver provides a method for USB UART switching.

config YL_DEBUG
	bool "Yulong debug logging support"
	help
	  Enable YL_DEBUG macro

config APP_PROFILE
	bool "Support for apps to set hardware frequencies"
	help
	  Allow apps to set CPU/GPU frequencies

endmenu
```

## drivers/input/touchscreen/gt9xx_hq/Kconfig
```kconfig
#
# Goodix GT9xx Touchscreen driver
#

config TOUCHSCREEN_GT9XX_HQ_DRIVER
	tristate "Goodix GT9xx touchpanel (Huaqin variant) driver"
	depends on TOUCHSCREEN_GT9XX_HQ
	default n
	help
	  This is the main file for touchpanel driver for Goodix GT9xx
	  touchscreens.

	  Say Y here if you have a Goodix GT9xx touchscreen connected
	  to your system.

	  If unsure, say N.

	  To compile this driver as a module, choose M here: the
	  module will be called gt9xx.

config TOUCHSCREEN_GT9XX_HQ_UPDATE
	tristate "Goodix GT9xx touchpanel (Huaqin variang) auto update support"
	depends on TOUCHSCREEN_GT9XX_HQ_DRIVER
	default n
	help
	  This enables support for firmware update for Goodix GT9xx
	  touchscreens.

	  Say Y here if you have a Goodix GT9xx touchscreen connected
	  to your system.

	  If unsure, say N.

	  To compile this driver as a module, choose M here: the
	  module will be called gt9xx_update.

config TOUCHSCREEN_GT9XX_HQ_DEBUG
	tristate "Goodix GT9xx (Huaqin variang) Tools for debuging"
	depends on TOUCHSCREEN_GT9XX_HQ_DRIVER
	default n
	help
	  This is application debug interface support for Goodix GT9xx
	  touchscreens.

	  Say Y here if you want to have a Android app debug interface
	  to your system.

	  If unsure, say N.

	  To compile this driver as a module, choose M here: the
	  module will be called goodix_tool.
```

## drivers/input/touchscreen/gt9xx_wt/Kconfig
```kconfig
#
# Wingtech Goodix GT9xx Touchscreen driver
#

config TOUCHSCREEN_WT_GT9XX_UPDATE
	bool "Goodix touchpanel (Wingtech variant) firmware update"
	depends on TOUCHSCREEN_WT_GT9XX
	help
	  Say Y here if you want GT9xx (Wingtech) firmware update.

	  If unsure, say N.

config TOUCHSCREEN_WT_GT9XX_DEBUG
	bool "Goodix touchpanel (Wingtech variant) debug"
	depends on TOUCHSCREEN_WT_GT9XX
	help
	  Say Y here if you want GT9xx (Wingtech) extra debug.

	  If unsure, say N.
```

## drivers/input/touchscreen/gt9xx_yl/Kconfig
```kconfig
#
# Yulong Goodix GT9xx Touchscreen driver
#

config TOUCHSCREEN_GT9XX_YL_COVER_WINDOW_SIZE
	bool "Touchscreen cover window size"
	depends on TOUCHSCREEN_GT9XX_YL
	help
	  Say Y here if you want to set a size for cover window.
	  This is used for the IC that cann't support window mode in firmware.
	  So you can set a window size in your driver.

	  If unsure, say N.

config TOUCHSCREEN_GT9XX_YL_COVER_WINDOW_CFG
	bool "Touchscreen cover window config switch"
	depends on TOUCHSCREEN_GT9XX_YL
	help
	  Say Y here if you want to set conver window mode via switching a config file.
	  This is used for the IC(goodix) that can support window mode in firmware.
	  So you can set a window mode via a config.

	  If unsure, say N.

config TOUCHSCREEN_GT9XX_YL_TW_GLOVE_SWITCH
	bool "Touchscreen glove window switch"
	depends on TOUCHSCREEN_GT9XX_YL
	help
	  Say Y here if you want to set conver window mode.
	  This is used for the IC(syna) that cannt't support window mode in firmware.
	  So you can set a window mode in your driver.

	  If unsure, say N.
```

## drivers/platform/Kconfig
```kconfig
if X86
source "drivers/platform/x86/Kconfig"
endif
if GOLDFISH
source "drivers/platform/goldfish/Kconfig"
endif

if ARCH_MSM
source "drivers/platform/ckt/Kconfig"
source "drivers/platform/huaqin/Kconfig"
source "drivers/platform/longcheer/Kconfig"
source "drivers/platform/msm/Kconfig"
source "drivers/platform/haier/Kconfig"
source "drivers/platform/wingtech/Kconfig"
source "drivers/platform/yulong/Kconfig"
endif
```

## drivers/platform/ckt/Kconfig
```kconfig
# CK Telecom configuration options

config MACH_CKT
	bool "CK Telecom device"
	depends on ARCH_MSM
	help
	  Support for CK Telecom products

config MACH_CKT_MSM8939
	bool "CK Telecom MSM8939"
	depends on ARCH_MSM8916
	select MACH_CKT
	help
	  Support for CK Telecom MSM8939 variants

menu "CK Telecom board selection"

config MACH_SPIRIT
	bool "Spirit board"
	select MACH_CKT_MSM8939
	help
	  Support for CK Telecom Spirit variant

endmenu
```

## drivers/platform/haier/Kconfig
```kconfig
# Haier configuration options

config MACH_HAIER
	bool "Wingtech device"
	depends on ARCH_MSM
	help
	  Support for Haier products

config MACH_HAIER_MSM8916
	bool "Haier MSM8916"
	depends on ARCH_MSM8916
	select MACH_HAIER
	help
	  Support for MSM8916 Haier variants

menu "Haier board selection"

config MACH_RENDANG
	bool "Rendang board"
	select MACH_HAIER_MSM8916
	help
	  Support for Haier Rendang variant

endmenu
```

## drivers/platform/huaqin/Kconfig
```kconfig
# Huaqin configuration options

config MACH_HUAQIN
        bool "Huaqin device"
        depends on ARCH_MSM
        help
          Support for Huaqin products

config MACH_HUAQIN_MSM8916
        bool "Huaqin MSM8916"
        depends on ARCH_MSM8916
        select MACH_HUAQIN
        help
          Support for MSM8916 Huaqin variants

menu "Huaqin board selection"

config MACH_JALEBI
        bool "Jalebi board"
        select MACH_HUAQIN_MSM8916
        help
          Support for Huaqin Jalebi variant

endmenu
```

## drivers/platform/longcheer/Kconfig
```kconfig
# Longcheer configuration options

config MACH_LONGCHEER
	bool "Wingtech device"
	depends on ARCH_MSM
	help
	  Support for Longcheer products

config MACH_LONGCHEER_MSM8916
	bool "Longcheer MSM8916"
	depends on ARCH_MSM8916
	select MACH_LONGCHEER
	help
	  Support for MSM8916 Longcheer variants

menu "LC board selection"

config MACH_CRACKLING
	bool "Crackling board"
	select MACH_LONGCHEER_MSM8916
	help
	  Support for Longcheer Crackling variant

endmenu
```

## drivers/platform/smartfren/Kconfig
```kconfig
menu "Yulong/Coolpad specific drivers"

config MACH_RENDANG_MSM8916
        bool "Rendang MSM8916"
        depends on ARCH_MSM8916
        help
          Support for Rendang 8916 device

endmenu
```

## drivers/platform/wingtech/Kconfig
```kconfig
# Wingtech configuration options

config MACH_WINGTECH
	bool "Wingtech device"
	depends on ARCH_MSM
	help
	  Support for Wingtech products

config MACH_WINGTECH_MSM8916
	bool "Wingtech MSM8916"
	depends on ARCH_MSM8916
	select MACH_WINGTECH
	help
	  Support for MSM8916 Wingtech variants

menu "Wingtech board selection"

config MACH_T86519A1
	bool "T86519A1 board"
	select MACH_WINGTECH_MSM8916
	help
	  Support for Wingtech T86519A1 variant

endmenu
```

## drivers/platform/yulong/Kconfig
```kconfig
# Yulong/Coolpad configuration options

config MACH_YULONG
	bool "Yulong device"
	depends on ARCH_MSM
	help
	  Support for Yulong products

config MACH_YULONG_MSM8939
	bool "Yulong MSM8939"
	depends on ARCH_MSM8916
	select MACH_YULONG
	help
	  Support for MSM8939 Yulong variants

menu "Yulong board selection"

config MACH_CP8675
	bool "CP8675_I01 board"
	select MACH_YULONG_MSM8939
	help
	  Support for Yulong CP8675_I01 variant

endmenu

menu "Yulong features"

config YL_POWEROFF_ALARM
	bool "Support Yulong power-off alarm"
	help
	  Use Yulong implementation of RTC wakeup alarms.

endmenu
```

## drivers/sensors/Kconfig
```kconfig
config SENSORS
	bool "Sensors Class Support"
	help
	  This option enables the sensor sysfs class in /sys/class/sensors.
	  You'll need this to do anything useful with sensorss. If unsure, say N.

config SENSORS_SSC
	bool "Enable Sensors Driver Support for SSC"
	help
	  Add support for sensors SSC driver.
	  This driver is used for exercising sensors use case,
	  time syncing with ADSP clock.

menu "Sensors Device Drivers"

config YL_SENSORS
	tristate "Yulong sensor support" if EXPERT
	default y
	help
	  Say Y here if you have any sensor device (accelerometer, light, proximity,
	  compass, ...) connected to your system and want it to be available to applications.
	  Say N here if you have a headless (no proximity, no compass) system.
	  If unsure, say Y.

if YL_SENSORS
source "drivers/sensors/sensparams/Kconfig"
endif

endmenu
```

## drivers/sensors/accel/Kconfig
```kconfig
############################################
## 	Kconfig for acc sensors devices 			
## 	Author:LongJiang 									
## 	Date:2013-09-13 									
############################################

menu "Sensors Device Drivers"

config YL_SENSORS_GSENSOR
	tristate "Generic sensor layer (needed for BMA250E, KXTJ2-1009, ...)" if EXPERT
    depends on I2C
	default n
	help
	  Say Y here if you have any sensor device (BMA250E, KXTJ2-1009, ...) 
	  connected to your system and want it to be available to applications.
	  
	  Say N here if you have a headless (no BMA250E, no KXTJ2-1009) system.

	  If unsure, say Y.
	  
config YL_ACCELER_RANGE_CALIBRATE
	tristate "Generic sensor layer (needed for BMA250E, KXTJ2-1009, ...)" if EXPERT
	default n
	help
	  If unsure, say N.
	  
if YL_SENSORS_GSENSOR
source "drivers/sensors/accel/bma2x2/Kconfig"
source "drivers/sensors/accel/kionix/Kconfig"
source "drivers/sensors/accel/lis3dh/Kconfig"
endif

endmenu
```

## drivers/sensors/accel/bma2x2/Kconfig
```kconfig
############################################
## 	Kconfig for accel sensors devices 			
## 	Author:LongJiang 									
## 	Date:2013-09-13 									
############################################

#
# Miscellaneous I2C chip drivers configuration
#
# *** DEPRECATED! Do not add new entries! See Makefile ***
#

menu "Miscellaneous I2C Chip support"

config YL_BMA2x2_GSENSOR
	tristate "BMA255/BMA250E/BMA222E/BMA280 acceleration sensor support"
	depends on I2C
	default n	
	help
	  If you say yes here you get support for Bosch Sensortec's 
	  acceleration sensors BMA255/BMA250E/BMA222E/BMA280.

endmenu
```
