## drivers/sensors/accel/kionix/Kconfig
```kconfig
############################################
## 	Kconfig for acc sensors devices 			
## 	Author:LongJiang 									
## 	Date:2013-09-25 									
############################################
	  
config YL_KIONIX_GSENSOR
	tristate "KIONIX_ACCEL"
	depends on I2C && SYSFS
	default n	
	help
		If you say yes here you get support for the Kionix digital 
		3-axis accelerometer.
	
		This driver can also be built as a module.If so, the module
		will be called kionix_accel.		
```

## drivers/sensors/alsprox/Kconfig
```kconfig
###########################################
## 	Kconfig for alsprox sensors devices
## 	Author:LongJiang
## 	Date:2013-09-13
############################################

menu "alsprox-sensor Device Drivers"

config YL_SENSORS_ALSPROX
	tristate "Generic sensor layer (needed for taos, ltr559, ...)" if EXPERT
	depends on I2C
	default n
	help
	  Say Y here if you have any sensor device (taos, ltr559, ...)
	  connected to your system and want it to be available to applications.
	  Say N here if you have a headless (no taos, no ltr559) system.
	  If unsure, say Y.

if YL_SENSORS_ALSPROX
source "drivers/sensors/alsprox/tmd277x/Kconfig"
source "drivers/sensors/alsprox/cm36682/Kconfig"
source "drivers/sensors/alsprox/cm32131/Kconfig"
source "drivers/sensors/alsprox/ltr559/Kconfig"
source "drivers/sensors/alsprox/ltr558/Kconfig"
source "drivers/sensors/alsprox/al3320/Kconfig"
source "drivers/sensors/alsprox/pa12200001/Kconfig"
endif

endmenu
```

## drivers/sensors/alsprox/al3320/Kconfig
```kconfig
config YL_AL3320_ALSPROX
	tristate "al3320 ALS Support"
	depends on I2C=y
	help
	  al3320 ALS Driver
```

## drivers/sensors/alsprox/cm32131/Kconfig
```kconfig
config YL_CM32131_ALSPROX
	tristate "CM32131 ALS Support"
	depends on I2C=y
	help
	  cm36682 ALS Driver
```

## drivers/sensors/alsprox/cm36682/Kconfig
```kconfig
config YL_CM36682_ALSPROX
	tristate "CM36682 ALS&Proximity Support"
	depends on I2C=y
	help
	  cm36682 ALS&Proximity Driver
	  
```

## drivers/sensors/alsprox/ltr558/Kconfig
```kconfig
config YL_LTR558_ALSPROX
	tristate "ltr558 ALS&Proximity Support"
	depends on I2C
	default n	
	help
	  ltr558 ALS&Proximity Driver
	  
```

## drivers/sensors/alsprox/ltr559/Kconfig
```kconfig
############################################
## 	Kconfig for alsprox sensors devices	
## 	Author:LongJiang 									
## 	Date:2013-09-30 									
############################################

config YL_LTR559_ALSPROX
	tristate "LTR559 Ambient & Promixity Sensor Driver"
	depends on I2C
	default n
	help
	 LTR559 Ambient & Promixity Sensor Driver implemented by YL.
```

## drivers/sensors/alsprox/pa12200001/Kconfig
```kconfig
############################################
## 	Kconfig for alsprox sensors devices	
																		
############################################

config YL_TXC_PA12200001
	tristate "TXC_PA12200001 P/L sensor support"
	default n
	depends on I2C=y
	help
	  If you say yes here you get support for TXC's proximity
	  and light sensors PA12200001.
```
